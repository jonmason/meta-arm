## meta-arm-bsp/conf/machine/corstone700-fvp.conf
```bitbake
#@TYPE: Machine
#@NAME: corstone700-fvp machine
#@DESCRIPTION: Machine configuration for Corstone700 FVP

require conf/machine/include/corstone700.inc

# default feature used: eth_lan91c111
# add the following line to local.conf to disable the feature:
# MACHINE_FEATURES:remove = "eth_lan91c111"
MACHINE_FEATURES += "eth_lan91c111"

TFA_TARGET_PLATFORM = "fvp"
```

## meta-arm-bsp/conf/machine/corstone700-mps3.conf
```bitbake
#@TYPE: Machine
#@NAME: corstone700-mps3 machine
#@DESCRIPTION: Machine configuration for Corstone700 MPS3

require conf/machine/include/corstone700.inc

# default feature used: eth_lan9115
# add the following line to local.conf to disable the feature:
# MACHINE_FEATURES:remove = "eth_lan9115"
MACHINE_FEATURES += "eth_lan9115"

# default feature used: usb_host
# add the following line to local.conf to disable the feature:
# MACHINE_FEATURES:remove = "usb_host"
MACHINE_FEATURES += "usb_host"

TFA_TARGET_PLATFORM = "fpga"
```

## meta-arm-bsp/conf/machine/foundation-armv8.conf
```bitbake
# Configuration for Armv8-A Foundation

#@TYPE: Machine
#@NAME: Armv8-A Foundation Platform machine
#@DESCRIPTION: Machine configuration for Armv8-A Foundation Platform model

require conf/machine/fvp-common.inc
require conf/machine/include/arm/arch-armv8a.inc

TUNE_FEATURES = "aarch64"

# FVP u-boot configuration
UBOOT_MACHINE = "vexpress_aemv8a_semi_defconfig"

KERNEL_IMAGETYPE = "Image"

KERNEL_DEVICETREE = "arm/foundation-v8-gicv3-psci.dtb"
```

## meta-arm-bsp/conf/machine/fvp-base-arm32.conf
```bitbake
# Configuration for Armv7-A Base Platform FVP

#@TYPE: Machine
#@NAME: Armv7-A Base Platform FVP machine
#@DESCRIPTION: Machine configuration for Armv7-A Base Platform FVP model

require conf/machine/fvp-common.inc
require conf/machine/include/arm/arch-armv7a.inc

# FVP u-boot configuration
PREFERRED_VERSION_u-boot ?= "2021.10"
UBOOT_MACHINE = "vexpress_aemv8a_aarch32_defconfig"

KERNEL_IMAGETYPE = "zImage"

KERNEL_DEVICETREE = "arm/fvp-base-gicv3-psci-custom.dtb"

FVP_DATA ?= "cluster0.cpu0=${DEPLOY_DIR_IMAGE}/${KERNEL_IMAGETYPE}@0x80080000 \
             cluster0.cpu0=${DEPLOY_DIR_IMAGE}/fvp-base-gicv3-psci-custom.dtb@0x83000000"
FVP_CONFIG[cluster0.cpu0.CONFIG64] = "0"
FVP_CONFIG[cluster0.cpu1.CONFIG64] = "0"
FVP_CONFIG[cluster0.cpu2.CONFIG64] = "0"
FVP_CONFIG[cluster0.cpu3.CONFIG64] = "0"
FVP_CONFIG[cluster1.cpu0.CONFIG64] = "0"
FVP_CONFIG[cluster1.cpu1.CONFIG64] = "0"
FVP_CONFIG[cluster1.cpu2.CONFIG64] = "0"
FVP_CONFIG[cluster1.cpu3.CONFIG64] = "0"
```

## meta-arm-bsp/conf/machine/fvp-base.conf
```bitbake
# Configuration for Armv8-A Base Platform FVP

#@TYPE: Machine
#@NAME: Armv8-A Base Platform FVP machine
#@DESCRIPTION: Machine configuration for Armv8-A Base Platform FVP model

require conf/machine/fvp-common.inc
require conf/machine/include/arm/arch-armv8a.inc

TUNE_FEATURES = "aarch64"

# FVP u-boot configuration
UBOOT_MACHINE = "vexpress_aemv8a_semi_defconfig"

KERNEL_IMAGETYPE = "Image"

KERNEL_DEVICETREE = "arm/fvp-base-revc.dtb"

FVP_DATA ?= "cluster0.cpu0=${DEPLOY_DIR_IMAGE}/${KERNEL_IMAGETYPE}@0x80080000 \
             cluster0.cpu0=${DEPLOY_DIR_IMAGE}/fvp-base-revc.dtb@0x83000000"
```

## meta-arm-bsp/conf/machine/fvp-baser-aemv8r64.conf
```bitbake
# Configuration for Fixed Virtual Platform BaseR AEMv8r64 Machine

#@TYPE: Machine
#@NAME: FVP BaseR AEMv8r64 Machine
#@DESCRIPTION: Machine configuration for FVP BaseR AEMv8r64

require conf/machine/include/arm/armv8r/arch-armv8r64.inc

EXTRA_IMAGEDEPENDS += "boot-wrapper-aarch64"

PREFERRED_PROVIDER_virtual/kernel ?= "linux-yocto"
PREFERRED_VERSION_linux-yocto ?= "5.10%"

KERNEL_IMAGETYPE = "Image"
KERNEL_DEVICETREE = "arm/fvp-baser-aemv8r64.dtb"

SERIAL_CONSOLES = "115200;ttyAMA0"

IMAGE_FSTYPES += "wic"
WKS_FILE ?= "${MACHINE}.wks"

# As this is a virtual target that will not be used in the real world there is
# no need for real SSH keys.  Disable rng-tools (which takes too long to
# initialise) and install the pre-generated keys.
PACKAGECONFIG_remove_pn-openssh = "rng-tools"
MACHINE_EXTRA_RRECOMMENDS += "ssh-pregen-hostkeys"
```
