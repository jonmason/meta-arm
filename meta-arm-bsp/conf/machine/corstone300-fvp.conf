## meta-arm-bsp/conf/machine/corstone300-fvp.conf
```bitbake
#@TYPE: Machine
#@NAME: corstone300-fvp
#@DESCRIPTION: Arm Corstone-300 Fixed Virtual Platform

DEFAULTTUNE = "armv8-1m-main"
require conf/machine/include/arm/armv8-1m/tune-cortexm55.inc

TCLIBC = "newlib"
TFM_PLATFORM = "arm/mps3/corstone300/fvp"
COMPATIBLE_MACHINE:pn-trusted-firmware-m-tests = "corstone300-fvp"
TFM_TEST_FVP = "FVP_Corstone_SSE-300_Ethos-U55"
TFM_TEST_MODEL_DEPENDS:pn-trusted-firmware-m-tests = "fvp-corstone300-native:do_populate_sysroot"
TFM_TEST_IMAGE_ADDR = "0x38000000"
```

## meta-arm-bsp/conf/machine/corstone310-fvp.conf
```bitbake
#@TYPE: Machine
#@NAME: corstone310-fvp
#@DESCRIPTION: Arm Corstone-310 Fixed Virtual Platform

DEFAULTTUNE = "armv8-1m-main"
require conf/machine/include/arm/arch-armv8-1m-main.inc

TCLIBC = "newlib"
TFM_PLATFORM = "arm/mps3/corstone310/fvp"
COMPATIBLE_MACHINE:pn-trusted-firmware-m-tests = "corstone310-fvp"
TFM_TEST_FVP = "FVP_Corstone_SSE-310"
TFM_TEST_MODEL_DEPENDS:pn-trusted-firmware-m-tests = "fvp-corstone310-native:do_populate_sysroot"
TFM_TEST_IMAGE_ADDR = "0x38000000"
```

## meta-arm-bsp/conf/machine/mps3-an524.conf
```bitbake
#@TYPE: Machine
#@NAME: mps3-an524
#@DESCRIPTION: Arm MPS3 AN524 for Trusted Firmware-M

DEFAULTTUNE = "armv8m-main"
require conf/machine/include/arm/armv8-m/tune-cortexm33.inc

TCLIBC = "newlib"
TFM_PLATFORM = "arm/mps3/an524"
COMPATIBLE_MACHINE:pn-trusted-firmware-m-tests = "mps3-an524"
TFM_TEST_QEMU_MACHINE = "mps3-an524,remap=QSPI"
TFM_TEST_BL2_ADDR = "0x10000000"
TFM_TEST_IMAGE_ADDR = "0x10040000"
```

## meta-arm-bsp/conf/machine/rdv3.conf
```bitbake
# Configuration for Arm Neoverse v3 Reference Design development board

#@TYPE: Machine
#@NAME: RD V3
#@DESCRIPTION: Machine configuration for RD V3

require conf/machine/include/arm/arch-armv9a.inc

EXTRA_IMAGEDEPENDS += "rdv3-firmware-image:do_deploy"

KERNEL_IMAGETYPE ?= "Image"
PREFERRED_PROVIDER_virtual/kernel:forcevariable = "linux-yocto"
SERIAL_CONSOLES = "115200;ttyAMA0 115200;ttyAMA1"

EFI_PROVIDER ?= "${@bb.utils.contains("DISTRO_FEATURES", "systemd", "systemd-boot", "grub-efi", d)}"
MACHINE_FEATURES += "efi"

IMAGE_FSTYPES:forcevariable = "cpio.gz wic"
IMAGE_NAME_SUFFIX = ""
IMAGE_CLASSES += "fvpboot"

WKS_FILE ?= "rdv3-efi-disk.wks.in"
WKS_FILE_DEPENDS:append = " rdv3-firmware-image"

# Image tests
TEST_TARGET = "OEFVPTarget"
TEST_TARGET_IP = "127.0.0.1:2222"
TEST_SUITES = "fvp_boot"
DEFAULT_TEST_SUITES:append = " fvp_boot fvp_devices"
TEST_FVP_DEVICES ?= "rtc watchdog networking virtiorng cpu_hotplug"

# FVP configuration
FVP_PROVIDER ?= "fvp-rdv3-native"
FVP_EXE ?= "FVP_RD_V3"
FVP_EXTRA_ARGS ?= "-I -R"

FVP_CONFIG[css.sysctrl.rse.rom.raw_image] ?= "tf_m_rom.bin"
FVP_DATA ?= "css.sysctrl.rse.cpu=tf_m_flash.bin@0xB0000000 \
             css.sysctrl.rse.cpu=tf_m_vm0_0.bin@0x31000400 \
             css.sysctrl.rse.cpu=tf_m_vm1_0.bin@0x31080000"

FVP_CONFIG[ros.board.flashloader0.fname] ?= "fip-rdv3.bin"
FVP_CONFIG[ros.board.flashloader1.fname] ?= "nor1_flash.img"
FVP_CONFIG[ros.board.flashloader1.fnameWrite] ?= "nor1_flash.img"
FVP_CONFIG[ros.board.flashloader2.fname] ?= "nor2_flash.img"
FVP_CONFIG[ros.board.flashloader2.fnameWrite] ?= "nor2_flash.img"
FVP_CONFIG[css.sysctrl.rse.DISABLE_GATING] ?= "true"
FVP_CONFIG[css.sysctrl.HAS_RSE_CPU_PRIVATE_REGION] ?= "1"
FVP_CONFIG[css.sysctrl.mcp.pl011_uart_mcp.shutdown_tag] ?= "'shutting'"
FVP_CONFIG[pcie_group_0.pcie4.hierarchy_file_name] ?= "<default>"
FVP_CONFIG[pcie_group_0.pcie4.pcie_rc.ahci0.endpoint.ats_supported] ?= "true"
FVP_CONFIG[pcie_group_1.pcie4.hierarchy_file_name] ?= "example_pcie_hierarchy_1.json"
FVP_CONFIG[pcie_group_2.pcie4.hierarchy_file_name] ?= "example_pcie_hierarchy_2.json"
FVP_CONFIG[pcie_group_3.pcie4.hierarchy_file_name] ?= "example_pcie_hierarchy_3.json"
FVP_CONFIG[css.sysctrl.rse.intchecker.ICBC_RESET_VALUE] ?= "0x0000011B"

FVP_CONFIG[css.sysctrl.rse.CMU4_NUM_DB_CH] ?= "5"
FVP_CONFIG[css.sysctrl.scp.ap2scp_mhu_s.NUM_DB_CH] ?= "6"
FVP_CONFIG[css.sysctrl.scp.scp2ap_mhu_s.NUM_DB_CH] ?= "6"
FVP_CONFIG[css.sysctrl.rse.CMU0_NUM_DB_CH] ?= "16"

FVP_CONFIG[css.sysctrl.rse_uart.uart_enable] ?= "true"
FVP_CONFIG[css.sysctrl.rse_uart.unbuffered_output] ?= "true"
FVP_CONFIG[css.sysctrl.rse_uart.out_file] ?= "rdv3-rse.log"
FVP_CONFIG[css.sysctrl.scp.pl011_uart_scp.uart_enable] ?= "true"
FVP_CONFIG[css.sysctrl.scp.pl011_uart_scp.unbuffered_output] ?= "true"
FVP_CONFIG[css.sysctrl.scp.pl011_uart_scp.out_file] ?= "rdv3-scp.log"
FVP_CONFIG[css.sysctrl.scp.pl011_uart_lcp.uart_enable] ?= "true"
FVP_CONFIG[css.sysctrl.scp.pl011_uart_lcp.unbuffered_output] ?= "true"
FVP_CONFIG[css.sysctrl.scp.pl011_uart_lcp.out_file] ?= "rdv3-lcp.log"
FVP_CONFIG[css.sysctrl.scp.pl011_uart_lcp.baud_rate] ?= "115200"
FVP_CONFIG[css.sysctrl.scp.pl011_uart_lcp.clock_rate] ?= "24000000"
FVP_CONFIG[css.sysctrl.mcp.pl011_uart_mcp.uart_enable] ?= "true"
FVP_CONFIG[css.sysctrl.mcp.pl011_uart_mcp.unbuffered_output] ?= "true"
FVP_CONFIG[css.sysctrl.mcp.pl011_uart_mcp.out_file] ?= "rdv3-mcp.log"
FVP_CONFIG[css.ap_periph.sec_uart.uart_enable] ?= "true"
FVP_CONFIG[css.ap_periph.sec_uart.unbuffered_output] ?= "true"
FVP_CONFIG[css.ap_periph.sec_uart.out_file] ?= "rdv3-secure.log"
FVP_CONFIG[css.ap_periph.ns_uart0.uart_enable] ?= "true"
FVP_CONFIG[css.ap_periph.ns_uart0.unbuffered_output] ?= "true"
FVP_CONFIG[css.ap_periph.ns_uart0.out_file] ?= "rdv3-linux.log"
FVP_CONFIG[css.ap_periph.ns_uart1.uart_enable] ?= "true"
FVP_CONFIG[css.ap_periph.ns_uart1.unbuffered_output] ?= "true"
FVP_CONFIG[css.ap_periph.ns_uart1.out_file] ?= "rdv3-rmm.log"

FVP_CONFIG[css.gic_distributor.ITS-device-bits] ?= "20"

FVP_CONSOLES[default] = "terminal_ns_uart0"
FVP_CONSOLES[rse] = "terminal_rse_uart"
FVP_CONSOLES[scp] = "terminal_uart_scp"
FVP_CONSOLES[mcp] = "terminal_uart_mcp"
FVP_CONSOLES[lcp] = "terminal_uart_lcp"
FVP_CONSOLES[secure] = "terminal_sec_uart"
FVP_TERMINALS[css.sysctrl.mcp.terminal_uart_mcp] ?= "MCP"
FVP_TERMINALS[css.sysctrl.scp.terminal_uart_scp] ?= "SCP"
FVP_TERMINALS[css.sysctrl.scp.terminal_uart_lcp] ?= "LCP"
FVP_TERMINALS[css.sysctrl.terminal_rse_uart] ?= "RSE"
FVP_TERMINALS[css.ap_periph.terminal_sec_uart] ?= "Secure"
FVP_TERMINALS[css.ap_periph.terminal_ns_uart0] ?= "Linux"
FVP_TERMINALS[css.ap_periph.terminal_ns_uart1] ?= "RMM"
FVP_TERMINALS[ros.soc.terminal_s0] ?= ""
FVP_TERMINALS[ros.soc.terminal_s1] ?= ""
FVP_TERMINALS[ros.board.terminal_0] ?= ""
FVP_TERMINALS[ros.board.terminal_1] ?= ""
# Virtio disk
FVP_CONFIG[ros.board.virtioblockdevice.image_path] ?= "${IMAGE_NAME}.wic"
```

## meta-arm-bsp/conf/machine/tc3.conf
```bitbake
#@TYPE: Machine
#@NAME: TC3 FVP
#@DESCRIPTION: Arm Total Compute 3 Fixed Virtual Platform

require conf/machine/include/arm/arch-armv9a.inc

MACHINEOVERRIDES =. "tc:"

PREFERRED_PROVIDER_virtual/kernel = "linux-yocto"
KERNEL_IMAGETYPE = "Image"
KERNEL_CLASSES = "kernel-fit-extra-artifacts"
INITRAMFS_IMAGE = "core-image-minimal"

UBOOT_MACHINE = "total_compute_defconfig"
UBOOT_LOADADDRESS = "0x80080000"
UBOOT_ENTRYPOINT = "0x80080000"
UBOOT_RD_LOADADDRESS = "0x88000000"
UBOOT_RD_ENTRYPOINT = "0x88000000"

IMAGE_FSTYPES += "cpio.gz"
IMAGE_NAME_SUFFIX = ""
IMAGE_CLASSES += "fvpboot"
SERIAL_CONSOLES = "115200;ttyAMA0"

EXTRA_IMAGEDEPENDS += "tc3-firmware-image"
TESTIMAGEDEPENDS:append = " linux-yocto-fitimage:do_deploy"
TEST_TARGET = "OEFVPTarget"
TEST_SUITES = "fvp_boot"
TEST_FVP_LINUX_BOOT_TIMEOUT = "900"

FVP_PROVIDER = "fvp-tc3-native"
FVP_EXE = "FVP_TC3"
FVP_CONSOLES[default] = "terminal_uart_ap"
FVP_TERMINALS[css.terminal_uart_ap] = "AP Console"
FVP_TERMINALS[css.terminal_uart1_ap] = "Secure Console"
FVP_TERMINALS[soc.terminal_s0] = "SCP Console"
FVP_TERMINALS[soc.terminal_s1] = "RSE Console"

FVP_CONFIG[board.flashloader0.fname] = "tc3-firmware-image/fip_gpt-tc.bin"
FVP_CONFIG[css.sms.rse.rom.raw_image] = "trusted-firmware-m/bl1_1.bin"
FVP_CONFIG[css.sms.rse.VMADDRWIDTH] = "16"
FVP_CONFIG[css.sms.rse.intchecker.ICBC_RESET_VALUE] = "0x0000011B"
FVP_CONFIG[css.sms.rse.sic.SIC_AUTH_ENABLE] = "1"
FVP_CONFIG[css.sms.rse.sic.SIC_DECRYPT_ENABLE] = "1"

FVP_DATA = "css.sms.rse.sram0=trusted-firmware-m/cm_provisioning_message.bin@0x400 \
            css.sms.rse.sram1=trusted-firmware-m/dm_provisioning_message.bin@0x0 \
            board.dram=fitImage-core-image-minimal-tc3-tc3@0x20000000"
```

## meta-arm/conf/machine/mps2-an521.conf
```bitbake
#@TYPE: Machine
#@NAME: mps2-an521
#@DESCRIPTION: Arm MPS2 AN521 for Trusted Firmware-M

DEFAULTTUNE = "armv8m-main"
require conf/machine/include/arm/armv8-m/tune-cortexm33.inc

TCLIBC = "newlib"
TFM_PLATFORM = "arm/mps2/an521"
COMPATIBLE_MACHINE:pn-trusted-firmware-m-tests = "mps2-an521"
TFM_TEST_QEMU_MACHINE = "mps2-an521"
TFM_TEST_BL2_ADDR = "0x10000000"
TFM_TEST_IMAGE_ADDR = "0x10080000"
```
