## meta-arm-bsp/conf/machine/rdv3r1.conf
```bitbake
# Configuration for the two-chip Arm Neoverse RD V3 R1

#@TYPE: Machine
#@NAME: RD V3 R1
#@DESCRIPTION: Machine configuration for RD V3 R1

require conf/machine/include/arm/arch-armv9a.inc

EXTRA_IMAGEDEPENDS += "rdv3r1-firmware-image:do_deploy"

KERNEL_IMAGETYPE ?= "Image"
PREFERRED_PROVIDER_virtual/kernel:forcevariable = "linux-yocto"
SERIAL_CONSOLES = "115200;ttyAMA0 115200;ttyAMA1"

EFI_PROVIDER ?= "${@bb.utils.contains("DISTRO_FEATURES", "systemd", "systemd-boot", "grub-efi", d)}"
MACHINE_FEATURES += "efi"

IMAGE_FSTYPES:forcevariable = "cpio.gz wic"
IMAGE_NAME_SUFFIX = ""
IMAGE_CLASSES += "fvpboot"

WKS_FILE ?= "efi-disk.wks.in"
WKS_FILE_DEPENDS:append = " rdv3r1-firmware-image"

TEST_TARGET = "OEFVPTarget"
TEST_TARGET_IP = "127.0.0.1:2222"
DEFAULT_TEST_SUITES:append = " fvp_boot fvp_devices"
TEST_FVP_DEVICES ?= "rtc watchdog networking virtiorng cpu_hotplug"

FVP_PROVIDER ?= "fvp-rdv3-r1-native"
FVP_EXE ?= "FVP_RD_V3_R1"
FVP_EXTRA_ARGS ?= "-I -R"

FVP_CONFIG[socket0.css0.sysctrl.rse.rom.raw_image] ?= "tf_m_rom.bin"
FVP_CONFIG[socket0.css1.sysctrl.rse.rom.raw_image] ?= "tf_m_rom.bin"
FVP_DATA ?= "socket0.css0.sysctrl.rse.cpu=tf_m_flash.bin@0xB0000000 \
             socket0.css0.sysctrl.rse.cpu=tf_m_vm0_0.bin@0x31000400 \
             socket0.css0.sysctrl.rse.cpu=tf_m_vm1_0.bin@0x31080000 \
             socket0.css1.sysctrl.rse.cpu=tf_m_flash.bin@0xB0000000 \
             socket0.css1.sysctrl.rse.cpu=tf_m_vm0_1.bin@0x31000400 \
             socket0.css1.sysctrl.rse.cpu=tf_m_vm1_1.bin@0x31080000"

FVP_CONFIG[socket0.ros0.flashloader0.fname] ?= "fip-rdv3r1.bin"
FVP_CONFIG[socket0.ros0.flashloader1.fname] ?= "nor1_flash.img"
FVP_CONFIG[socket0.ros0.flashloader1.fnameWrite] ?= "nor1_flash.img"
FVP_CONFIG[socket0.ros0.flashloader2.fname] ?= "nor2_flash.img"
FVP_CONFIG[socket0.ros0.flashloader2.fnameWrite] ?= "nor2_flash.img"

FVP_CONFIG[socket0.ros0.dram_2nd_range_base] ?= "0x20080000000"
FVP_CONFIG[socket0.ros0.dram_2nd_range_top] ?= "0x201FFFFFFFF"
FVP_CONFIG[socket0.ros1.dram_2nd_range_base] ?= "0x30080000000"
FVP_CONFIG[socket0.ros1.dram_2nd_range_top] ?= "0x301FFFFFFFF"

FVP_CONFIG[socket0.board0.rse2rse_mhu0.NUM_CH] ?= "16"
FVP_CONFIG[socket0.board1.rse2rse_mhu0.NUM_CH] ?= "16"
FVP_CONFIG[socket0.css0.sysctrl.rse.CMU4_NUM_DB_CH] ?= "5"
FVP_CONFIG[socket0.css1.sysctrl.rse.CMU4_NUM_DB_CH] ?= "5"
FVP_CONFIG[socket0.css0.sysctrl.rse.CMU0_NUM_DB_CH] ?= "16"
FVP_CONFIG[socket0.css1.sysctrl.rse.CMU0_NUM_DB_CH] ?= "16"
FVP_CONFIG[socket0.css0.sysctrl.rse.DISABLE_GATING] ?= "true"
FVP_CONFIG[socket0.css1.sysctrl.rse.DISABLE_GATING] ?= "true"
FVP_CONFIG[socket0.css0.gic_distributor.SPI-blocks] ?= "60"
FVP_CONFIG[socket0.css1.gic_distributor.SPI-blocks] ?= "60"
FVP_CONFIG[socket0.css0.gic_distributor.enable-local-cross-chip-addressing] ?= "false"
FVP_CONFIG[socket0.css1.gic_distributor.enable-local-cross-chip-addressing] ?= "false"

FVP_CONFIG[socket0.pcie_group0_to_css0.pcie4.hierarchy_file_name] ?= "<default>"
FVP_CONFIG[socket0.pcie_group1_to_css0.pcie4.hierarchy_file_name] ?= "<default>"
FVP_CONFIG[socket0.pcie_group0_to_css1.pcie4.hierarchy_file_name] ?= "<default>"
FVP_CONFIG[socket0.pcie_group1_to_css1.pcie4.hierarchy_file_name] ?= "<default>"
FVP_CONFIG[socket0.pcie_group0_to_css0.pcie4.pcie_rc.ahci0.endpoint.ats_supported] ?= "true"
FVP_CONFIG[socket0.pcie_group1_to_css0.pcie4.pcie_rc.ahci0.endpoint.ats_supported] ?= "true"
FVP_CONFIG[socket0.pcie_group0_to_css1.pcie4.pcie_rc.ahci0.endpoint.ats_supported] ?= "true"
FVP_CONFIG[socket0.pcie_group1_to_css1.pcie4.pcie_rc.ahci0.endpoint.ats_supported] ?= "true"

# Match the PCIe address windows used by the RD-INFRA model launcher.
FVP_CONFIG[socket0.pcie_group0_to_css0.pcie0.cfg_start] ?= "0x10000000000"
FVP_CONFIG[socket0.pcie_group0_to_css0.pcie0.cfg_end] ?= "0x1000FFFFFFF"
FVP_CONFIG[socket0.pcie_group0_to_css0.pcie0.mem1_start] ?= "0x10100000000"
FVP_CONFIG[socket0.pcie_group0_to_css0.pcie0.mem1_end] ?= "0x110FFFFFFFF"
FVP_CONFIG[socket0.pcie_group0_to_css0.pcie1.cfg_start] ?= "0x10000000000"
FVP_CONFIG[socket0.pcie_group0_to_css0.pcie1.cfg_end] ?= "0x1000FFFFFFF"
FVP_CONFIG[socket0.pcie_group0_to_css0.pcie1.mem1_start] ?= "0x10100000000"
FVP_CONFIG[socket0.pcie_group0_to_css0.pcie1.mem1_end] ?= "0x110FFFFFFFF"
FVP_CONFIG[socket0.pcie_group0_to_css0.pcie2.cfg_start] ?= "0x10000000000"
FVP_CONFIG[socket0.pcie_group0_to_css0.pcie2.cfg_end] ?= "0x1000FFFFFFF"
FVP_CONFIG[socket0.pcie_group0_to_css0.pcie2.mem1_start] ?= "0x10100000000"
FVP_CONFIG[socket0.pcie_group0_to_css0.pcie2.mem1_end] ?= "0x110FFFFFFFF"
FVP_CONFIG[socket0.pcie_group0_to_css0.pcie3.cfg_start] ?= "0x10000000000"
FVP_CONFIG[socket0.pcie_group0_to_css0.pcie3.cfg_end] ?= "0x1000FFFFFFF"
FVP_CONFIG[socket0.pcie_group0_to_css0.pcie3.mem1_start] ?= "0x10100000000"
FVP_CONFIG[socket0.pcie_group0_to_css0.pcie3.mem1_end] ?= "0x110FFFFFFFF"
FVP_CONFIG[socket0.pcie_group0_to_css0.pcie4.cfg_start] ?= "0x10000000000"
FVP_CONFIG[socket0.pcie_group0_to_css0.pcie4.cfg_end] ?= "0x1000FFFFFFF"
FVP_CONFIG[socket0.pcie_group0_to_css0.pcie4.mem1_start] ?= "0x10100000000"
FVP_CONFIG[socket0.pcie_group0_to_css0.pcie4.mem1_end] ?= "0x110FFFFFFFF"
FVP_CONFIG[socket0.pcie_group1_to_css0.pcie0.cfg_start] ?= "0x10000000000"
FVP_CONFIG[socket0.pcie_group1_to_css0.pcie0.cfg_end] ?= "0x1000FFFFFFF"
FVP_CONFIG[socket0.pcie_group1_to_css0.pcie0.mem1_start] ?= "0x10100000000"
FVP_CONFIG[socket0.pcie_group1_to_css0.pcie0.mem1_end] ?= "0x110FFFFFFFF"
FVP_CONFIG[socket0.pcie_group1_to_css0.pcie1.cfg_start] ?= "0x10000000000"
FVP_CONFIG[socket0.pcie_group1_to_css0.pcie1.cfg_end] ?= "0x1000FFFFFFF"
FVP_CONFIG[socket0.pcie_group1_to_css0.pcie1.mem1_start] ?= "0x10100000000"
FVP_CONFIG[socket0.pcie_group1_to_css0.pcie1.mem1_end] ?= "0x110FFFFFFFF"
FVP_CONFIG[socket0.pcie_group1_to_css0.pcie2.cfg_start] ?= "0x10000000000"
FVP_CONFIG[socket0.pcie_group1_to_css0.pcie2.cfg_end] ?= "0x1000FFFFFFF"
FVP_CONFIG[socket0.pcie_group1_to_css0.pcie2.mem1_start] ?= "0x10100000000"
FVP_CONFIG[socket0.pcie_group1_to_css0.pcie2.mem1_end] ?= "0x110FFFFFFFF"
FVP_CONFIG[socket0.pcie_group1_to_css0.pcie3.cfg_start] ?= "0x10000000000"
FVP_CONFIG[socket0.pcie_group1_to_css0.pcie3.cfg_end] ?= "0x1000FFFFFFF"
FVP_CONFIG[socket0.pcie_group1_to_css0.pcie3.mem1_start] ?= "0x10100000000"
FVP_CONFIG[socket0.pcie_group1_to_css0.pcie3.mem1_end] ?= "0x110FFFFFFFF"
FVP_CONFIG[socket0.pcie_group1_to_css0.pcie4.cfg_start] ?= "0x10000000000"
FVP_CONFIG[socket0.pcie_group1_to_css0.pcie4.cfg_end] ?= "0x1000FFFFFFF"
FVP_CONFIG[socket0.pcie_group1_to_css0.pcie4.mem1_start] ?= "0x10100000000"
FVP_CONFIG[socket0.pcie_group1_to_css0.pcie4.mem1_end] ?= "0x110FFFFFFFF"
FVP_CONFIG[socket0.pcie_group0_to_css1.pcie0.cfg_start] ?= "0x10010000000"
FVP_CONFIG[socket0.pcie_group0_to_css1.pcie0.cfg_end] ?= "0x1001FFFFFFF"
FVP_CONFIG[socket0.pcie_group0_to_css1.pcie0.mem1_start] ?= "0x11100000000"
FVP_CONFIG[socket0.pcie_group0_to_css1.pcie0.mem1_end] ?= "0x120FFFFFFFF"
FVP_CONFIG[socket0.pcie_group0_to_css1.pcie1.cfg_start] ?= "0x10010000000"
FVP_CONFIG[socket0.pcie_group0_to_css1.pcie1.cfg_end] ?= "0x1001FFFFFFF"
FVP_CONFIG[socket0.pcie_group0_to_css1.pcie1.mem1_start] ?= "0x11100000000"
FVP_CONFIG[socket0.pcie_group0_to_css1.pcie1.mem1_end] ?= "0x120FFFFFFFF"
FVP_CONFIG[socket0.pcie_group0_to_css1.pcie2.cfg_start] ?= "0x10010000000"
FVP_CONFIG[socket0.pcie_group0_to_css1.pcie2.cfg_end] ?= "0x1001FFFFFFF"
FVP_CONFIG[socket0.pcie_group0_to_css1.pcie2.mem1_start] ?= "0x11100000000"
FVP_CONFIG[socket0.pcie_group0_to_css1.pcie2.mem1_end] ?= "0x120FFFFFFFF"
FVP_CONFIG[socket0.pcie_group0_to_css1.pcie3.cfg_start] ?= "0x10010000000"
FVP_CONFIG[socket0.pcie_group0_to_css1.pcie3.cfg_end] ?= "0x1001FFFFFFF"
FVP_CONFIG[socket0.pcie_group0_to_css1.pcie3.mem1_start] ?= "0x11100000000"
FVP_CONFIG[socket0.pcie_group0_to_css1.pcie3.mem1_end] ?= "0x120FFFFFFFF"
FVP_CONFIG[socket0.pcie_group0_to_css1.pcie4.cfg_start] ?= "0x10010000000"
FVP_CONFIG[socket0.pcie_group0_to_css1.pcie4.cfg_end] ?= "0x1001FFFFFFF"
FVP_CONFIG[socket0.pcie_group0_to_css1.pcie4.mem1_start] ?= "0x11100000000"
FVP_CONFIG[socket0.pcie_group0_to_css1.pcie4.mem1_end] ?= "0x120FFFFFFFF"
FVP_CONFIG[socket0.pcie_group1_to_css1.pcie0.cfg_start] ?= "0x10010000000"
FVP_CONFIG[socket0.pcie_group1_to_css1.pcie0.cfg_end] ?= "0x1001FFFFFFF"
FVP_CONFIG[socket0.pcie_group1_to_css1.pcie0.mem1_start] ?= "0x11100000000"
FVP_CONFIG[socket0.pcie_group1_to_css1.pcie0.mem1_end] ?= "0x120FFFFFFFF"
FVP_CONFIG[socket0.pcie_group1_to_css1.pcie1.cfg_start] ?= "0x10010000000"
FVP_CONFIG[socket0.pcie_group1_to_css1.pcie1.cfg_end] ?= "0x1001FFFFFFF"
FVP_CONFIG[socket0.pcie_group1_to_css1.pcie1.mem1_start] ?= "0x11100000000"
FVP_CONFIG[socket0.pcie_group1_to_css1.pcie1.mem1_end] ?= "0x120FFFFFFFF"
FVP_CONFIG[socket0.pcie_group1_to_css1.pcie2.cfg_start] ?= "0x10010000000"
FVP_CONFIG[socket0.pcie_group1_to_css1.pcie2.cfg_end] ?= "0x1001FFFFFFF"
FVP_CONFIG[socket0.pcie_group1_to_css1.pcie2.mem1_start] ?= "0x11100000000"
FVP_CONFIG[socket0.pcie_group1_to_css1.pcie2.mem1_end] ?= "0x120FFFFFFFF"
FVP_CONFIG[socket0.pcie_group1_to_css1.pcie3.cfg_start] ?= "0x10010000000"
FVP_CONFIG[socket0.pcie_group1_to_css1.pcie3.cfg_end] ?= "0x1001FFFFFFF"
FVP_CONFIG[socket0.pcie_group1_to_css1.pcie3.mem1_start] ?= "0x11100000000"
FVP_CONFIG[socket0.pcie_group1_to_css1.pcie3.mem1_end] ?= "0x120FFFFFFFF"
FVP_CONFIG[socket0.pcie_group1_to_css1.pcie4.cfg_start] ?= "0x10010000000"
FVP_CONFIG[socket0.pcie_group1_to_css1.pcie4.cfg_end] ?= "0x1001FFFFFFF"
FVP_CONFIG[socket0.pcie_group1_to_css1.pcie4.mem1_start] ?= "0x11100000000"
FVP_CONFIG[socket0.pcie_group1_to_css1.pcie4.mem1_end] ?= "0x120FFFFFFFF"

FVP_CONFIG[socket0.ros0.virtio_net.enabled] ?= "1"
FVP_CONFIG[socket0.ros0.virtio_net.transport] ?= "legacy"
FVP_CONFIG[socket0.ros0.virtio_net.hostbridge.userNetworking] ?= "1"
FVP_CONFIG[socket0.ros0.virtio_net.hostbridge.userNetPorts] = "2222=22"
FVP_CONFIG[socket0.ros0.virtio_rng.enabled] ?= "1"
FVP_CONFIG[socket0.ros0.virtioblockdevice.image_path] ?= "${IMAGE_NAME}.wic"

FVP_CONSOLES[default] = "terminal_ns_uart0"
FVP_CONSOLES[rse] = "terminal_rse_uart"
FVP_CONSOLES[scp] = "terminal_uart_scp"
FVP_CONSOLES[mcp] = "terminal_uart_mcp"
FVP_CONSOLES[lcp] = "terminal_uart_lcp"
FVP_CONSOLES[secure] = "terminal_sec_uart"
FVP_TERMINALS[socket0.css0.sysctrl.terminal_rse_uart] ?= "RSE0"
FVP_TERMINALS[socket0.css0.sysctrl.scp.terminal_uart_scp] ?= "SCP0"
FVP_TERMINALS[socket0.css0.sysctrl.scp.terminal_uart_lcp] ?= "LCP0"
FVP_TERMINALS[socket0.css0.sysctrl.mcp.terminal_uart_mcp] ?= "MCP0"
FVP_TERMINALS[socket0.css0.ap_periph.terminal_sec_uart] ?= "Secure0"
FVP_TERMINALS[socket0.css0.ap_periph.terminal_ns_uart0] ?= "Linux"
FVP_TERMINALS[socket0.css0.ap_periph.terminal_ns_uart1] ?= "RMM"
FVP_TERMINALS[socket0.css1.sysctrl.terminal_rse_uart] ?= "RSE1"
FVP_TERMINALS[socket0.css1.sysctrl.scp.terminal_uart_scp] ?= "SCP1"
FVP_TERMINALS[socket0.css1.sysctrl.scp.terminal_uart_lcp] ?= "LCP1"
FVP_TERMINALS[socket0.css1.sysctrl.mcp.terminal_uart_mcp] ?= "MCP1"
FVP_TERMINALS[socket0.css1.ap_periph.terminal_sec_uart] ?= "Secure1"
FVP_TERMINALS[socket0.css1.ap_periph.terminal_ns_uart0] ?= "Linux1"
FVP_TERMINALS[socket0.css1.ap_periph.terminal_ns_uart1] ?= "RMM1"

TEST_FVP_LINUX_BOOT_TIMEOUT = "900"
```

## meta-arm/conf/machine/mps2-an521.conf
```bitbake
#@TYPE: Machine
#@NAME: mps2-an521
#@DESCRIPTION: Arm MPS2 AN521 for Trusted Firmware-M

DEFAULTTUNE = "armv8m-main"
require conf/machine/include/arm/armv8-m/tune-cortexm33.inc

TCLIBC = "newlib"
TFM_PLATFORM = "arm/mps2/an521"
QB_SYSTEM_NAME = "qemu-system-arm"
QB_MACHINE = "-machine mps2-an521"
TFM_TEST_BL2_ADDR = "0x10000000"
TFM_TEST_IMAGE_ADDR = "0x10080000"
```

## meta-arm/conf/machine/qemuarm64-secureboot.conf
```bitbake
MACHINEOVERRIDES =. "qemuarm64:"

require ${COREBASE}/meta/conf/machine/qemuarm64.conf

KMACHINE = "qemuarm64"

# secure=on can't ever use KVM, so force it off
QEMU_USE_KVM = ""

QB_MACHINE = "-machine virt,secure=on,acpi=off"
QB_MEM = "-m 1024"
QB_DEFAULT_FSTYPE = "wic.qcow2"
QB_DEFAULT_BIOS = "flash.bin"
QB_FSINFO = "wic:no-kernel-in-fs"
QB_ROOTFS_OPT = ""
QB_KERNEL_ROOT = "/dev/vda2"

IMAGE_FSTYPES += "wic wic.qcow2"

WKS_FILE ?= "qemu-u-boot.wks.in"
QEMU_WKS_CONFIGFILE = "qemuarm64.cfg"
WKS_FILE_DEPENDS:append = " trusted-firmware-a"
IMAGE_BOOT_FILES = "${KERNEL_IMAGETYPE}"

MACHINE_FEATURES += "optee-ftpm"
```
