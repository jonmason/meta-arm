## meta-arm-bsp/conf/machine/rdv1.conf
```bitbake
# Configuration for Arm Neoverse v1 Reference Design development board

#@TYPE: Machine
#@NAME: RD V1
#@DESCRIPTION: Machine configuration for RD V1

require  conf/machine/include/arm/armv8-4a/tune-neoversev1.inc

EXTRA_IMAGEDEPENDS += "virtual/control-processor-firmware"
EXTRA_IMAGEDEPENDS += "trusted-firmware-a"

KERNEL_IMAGETYPE ?= "Image"
PREFERRED_PROVIDER_virtual/kernel:forcevariable = "linux-yocto"
SERIAL_CONSOLES = "115200;ttyAMA0 115200;ttyAMA1"

EFI_PROVIDER ?= "${@bb.utils.contains("DISTRO_FEATURES", "systemd", "systemd-boot", "grub-efi", d)}"
MACHINE_FEATURES += "efi"

IMAGE_FSTYPES:forcevariable = "cpio.gz wic"
IMAGE_NAME_SUFFIX = ""
IMAGE_CLASSES += "fvpboot"

WKS_FILE ?= "efi-disk.wks.in"
WKS_FILE_DEPENDS:append = " ${EXTRA_IMAGEDEPENDS}"

# testimage config
TEST_TARGET = "OEFVPTarget"
#TEST_TARGET_IP = "127.0.0.1:2222"
TEST_SUITES = "fvp_boot"
#DEFAULT_TEST_SUITES:append = " fvp_boot fvp_devices"
#TEST_FVP_DEVICES ?= "rtc watchdog networking virtiorng cpu_hotplug"

# FVP Config
FVP_PROVIDER ?= "fvp-rdv1-native"
FVP_EXE ?= "FVP_RD_V1"

FVP_CONFIG[css.cmn_650.force_rnsam_internal] ?= "true"
FVP_DATA ?= "css.scp.armcortexm7ct=scp_ramfw.bin@0x0BD80000 \
             css.mcp.armcortexm7ct=mcp_ramfw.bin@0x0BF80000"

FVP_CONFIG[css.mcp.ROMloader.fname] ?= "mcp_romfw.bin"
FVP_CONFIG[css.scp.ROMloader.fname] ?= "scp_romfw.bin"

FVP_CONFIG[css.trustedBootROMloader.fname] ?= "bl1-rdv1.bin"
FVP_CONFIG[board.flashloader0.fname] ?= "fip-rdv1.bin"

FVP_CONSOLES[default] = "terminal_uart_ap"
FVP_TERMINALS[css.scp.terminal_uart_aon] ?= "SCP Console"
FVP_TERMINALS[css.mcp.terminal_uart0] ?= ""
FVP_TERMINALS[css.mcp.terminal_uart1] ?= ""
FVP_TERMINALS[css.terminal_uart_ap] ?= "Console"
FVP_TERMINALS[css.terminal_uart1_ap] ?= ""
FVP_TERMINALS[soc.terminal_s0] ?= ""
FVP_TERMINALS[soc.terminal_s1] ?= ""
FVP_TERMINALS[soc.terminal_mcp] ?= ""
FVP_TERMINALS[board.terminal_0] ?= ""
FVP_TERMINALS[board.terminal_1] ?= ""

FVP_CONFIG[css.gic_distributor.ITS-device-bits] ?= "20"

# Virtio configuration
FVP_CONFIG[board.virtio_net.enabled] ?= "1"
FVP_CONFIG[board.virtio_net.hostbridge.userNetworking] ?= "1"
FVP_CONFIG[board.virtio_net.hostbridge.userNetPorts] = "2222=22"
FVP_CONFIG[board.virtioblockdevice.image_path] ?= "${IMAGE_NAME}.wic"
```

## meta-arm-bsp/conf/machine/rdv2.conf
```bitbake
# Configuration for Arm Neoverse v2 Reference Design development board

#@TYPE: Machine
#@NAME: RD V2
#@DESCRIPTION: Machine configuration for RD V2

require conf/machine/include/arm/armv9a/tune-neoversev2.inc

EXTRA_IMAGEDEPENDS += "virtual/control-processor-firmware"
EXTRA_IMAGEDEPENDS += "trusted-firmware-a"

KERNEL_IMAGETYPE ?= "Image"
PREFERRED_PROVIDER_virtual/kernel:forcevariable = "linux-yocto"
SERIAL_CONSOLES = "115200;ttyAMA0 115200;ttyAMA1"

EFI_PROVIDER ?= "${@bb.utils.contains("DISTRO_FEATURES", "systemd", "systemd-boot", "grub-efi", d)}"
MACHINE_FEATURES += "efi"

IMAGE_FSTYPES:forcevariable = "cpio.gz wic"
IMAGE_NAME_SUFFIX = ""
IMAGE_CLASSES += "fvpboot"

WKS_FILE ?= "efi-disk.wks.in"
WKS_FILE_DEPENDS:append = " ${EXTRA_IMAGEDEPENDS}"

# testimage config
TEST_TARGET = "OEFVPTarget"
#TEST_TARGET_IP = "127.0.0.1:2222"
TEST_SUITES = "fvp_boot"
#DEFAULT_TEST_SUITES:append = " fvp_boot fvp_devices"
#TEST_FVP_DEVICES ?= "rtc watchdog networking virtiorng cpu_hotplug"

# FVP Config
FVP_PROVIDER ?= "fvp-rdv2-native"
FVP_EXE ?= "FVP_RD_V2"

#FVP_CONFIG[css.cmn_650.force_rnsam_internal] ?= "true"
FVP_DATA ?= "css.scp.armcortexm7ct=scp_ramfw.bin@0x0BD80000 \
             css.mcp.armcortexm7ct=mcp_ramfw.bin@0x0BF80000"

FVP_CONFIG[css.gic_distributor.ITS-device-bits] ?= "20"
FVP_CONFIG[css.mcp.ROMloader.fname] ?= "mcp_romfw.bin"
FVP_CONFIG[css.scp.ROMloader.fname] ?= "scp_romfw.bin"
FVP_CONFIG[css.trustedBootROMloader.fname] ?= "bl1-rdn2.bin"
FVP_CONFIG[board.flashloader0.fname] ?= "fip-rdn2.bin"
FVP_CONFIG[board.dram_size] ?= "0x200000000"

# Virtio configuration
FVP_CONFIG[board.virtio_net.enabled] ?= "1"
FVP_CONFIG[board.virtio_net.hostbridge.userNetworking] ?= "1"
FVP_CONFIG[board.virtio_net.hostbridge.userNetPorts] = "2222=22"
FVP_CONFIG[board.virtioblockdevice.image_path] ?= "${IMAGE_NAME}.wic"

FVP_CONSOLES[default] = "terminal_ns_uart_ap"
FVP_TERMINALS[css.scp.terminal_uart_scp] ?= "SCP Console"
FVP_TERMINALS[css.mcp.terminal_uart_mcp] ?= "MCP Console"
FVP_TERMINALS[css.terminal_ns_uart_ap] ?= "Console"
FVP_TERMINALS[css.terminal_s_uart_ap] ?= ""
FVP_TERMINALS[soc.nonPCIe_devices_iomacro.iomacro_terminal_0] ?= ""
FVP_TERMINALS[soc.nonPCIe_devices_iomacro.iomacro_terminal_1] ?= ""
FVP_TERMINALS[soc.terminal_s0] ?= ""
FVP_TERMINALS[soc.terminal_s1] ?= ""
FVP_TERMINALS[soc.terminal_mcp] ?= ""
FVP_TERMINALS[board.terminal_0] ?= ""
FVP_TERMINALS[board.terminal_1] ?= ""
```

## meta-arm-bsp/conf/machine/sgi575.conf
```bitbake
# Configuration for Arm SGI575 development board

#@TYPE: Machine
#@NAME: SGI575
#@DESCRIPTION: Machine configuration for SGI575

require conf/machine/include/arm/armv8-2a/tune-cortexa75.inc

EXTRA_IMAGEDEPENDS += "virtual/control-processor-firmware"

EXTRA_IMAGEDEPENDS += "trusted-firmware-a"
PREFERRED_VERSION_trusted-firmware-a ?= "2.9.%"

KERNEL_IMAGETYPE ?= "Image"
PREFERRED_PROVIDER_virtual/kernel ?= "linux-yocto"
SERIAL_CONSOLES = "115200;ttyAMA0"

#grub-efi
EFI_PROVIDER ?= "grub-efi"
MACHINE_FEATURES += "efi"

IMAGE_FSTYPES += "cpio.gz wic"

WKS_FILE ?= "sgi575-efidisk.wks"
WKS_FILE_DEPENDS:append = " ${EXTRA_IMAGEDEPENDS}"


#FVP Config

TEST_TARGET = "OEFVPTarget"
TEST_SUITES = "fvp_boot"

# FVP Config
FVP_PROVIDER ?= "fvp-sgi575-native"
FVP_EXE ?= "FVP_CSS_SGI-575"

# FVP Parameters
FVP_DATA ?= "css.scp.armcortexm7ct=scp_ramfw.bin@0x0BD80000"
FVP_CONFIG[css.mcp.ROMloader.fname] ?= "mcp_romfw.bin"
FVP_CONFIG[css.scp.ROMloader.fname] ?= "scp_romfw.bin"
FVP_CONFIG[css.trustedBootROMloader.fname] ?= "bl1-sgi575.bin"
FVP_CONFIG[board.flashloader0.fname] ?= "fip-sgi575.bin"

FVP_CONFIG[board.virtio_net.enabled] ?= "1"
FVP_CONFIG[board.virtio_net.hostbridge.userNetworking] ?= "1"
# Tell testimage to connect to localhost:2222, and forward that to SSH in the FVP.
FVP_CONFIG[board.virtio_net.hostbridge.userNetPorts] = "2222=22"

FVP_CONSOLE = "terminal_s1"
FVP_TERMINALS[soc.terminal_s0] ?= "Secure Console"
FVP_TERMINALS[soc.terminal_s1] ?= "Console"

# Boot image
#FVP_DATA ?= "board.dram=fitImage-core-image-minimal-tc1-tc1@0x20000000"
FVP_CONFIG[board.virtioblockdevice.image_path] ?= "${IMAGE_NAME}.wic"
```

## meta-arm-bsp/conf/machine/tc0.conf
```bitbake
# Configuration for TC0

#@TYPE: Machine
#@NAME: TC0
#@DESCRIPTION: Machine configuration for TC0

TUNE_FEATURES = "aarch64"

require conf/machine/include/arm/arch-armv8a.inc

# Das U-boot
UBOOT_MACHINE ?= "total_compute_defconfig"

# Trusted firmware A v2.3
PREFERRED_PROVIDER_virtual/trusted-firmware-a ?= "trusted-firmware-a"
PREFERRED_VERSION_trusted-firmware-a ?= "2.3%"

PREFERRED_PROVIDER_virtual/kernel ?= "linux-arm64-ack"
PREFERRED_VERSION_linux-arm64-ack ?= "5.4"

# Cannot use the default zImage on arm64
KERNEL_IMAGETYPE = "Image"
KERNEL_IMAGETYPES += " fitImage "
KERNEL_CLASSES = " kernel-fitimage "

IMAGE_FSTYPES += "cpio.gz"
INITRAMFS_IMAGE = "core-image-minimal"

UBOOT_RD_LOADADDRESS = "0x88000000"
UBOOT_RD_ENTRYPOINT = "0x88000000"
UBOOT_LOADADDRESS = "0x80080000"
UBOOT_ENTRYPOINT = "0x80080000"
UBOOT_SIGN_ENABLE = "1"
UBOOT_MKIMAGE_DTCOPTS = "-I dts -O dtb"
UBOOT_SIGN_KEYNAME = "dev_key"
UBOOT_SIGN_KEYDIR = "${DEPLOY_DIR_IMAGE}/keys"
FIT_GENERATE_KEYS = "1"

SERIAL_CONSOLES = "115200;ttyAMA0"
```

## meta-arm-bsp/conf/machine/tc2.conf
```bitbake
# Configuration for TC2

#@TYPE: Machine
#@NAME: TC2
#@DESCRIPTION: Machine configuration for TC2

TUNE_FEATURES = "aarch64"

require conf/machine/include/arm/arch-armv8a.inc

MACHINEOVERRIDES =. "tc:"

# Das U-boot
UBOOT_MACHINE ?= "total_compute_defconfig"
UBOOT_RD_LOADADDRESS = "0x88000000"
UBOOT_RD_ENTRYPOINT = "0x88000000"
UBOOT_LOADADDRESS = "0x80080000"
UBOOT_ENTRYPOINT = "0x80080000"

PREFERRED_PROVIDER_virtual/kernel ?= "linux-yocto"

# Cannot use the default zImage on arm64
KERNEL_IMAGETYPE = "Image"
KERNEL_IMAGETYPES += "fitImage"
KERNEL_CLASSES = " kernel-fitimage "

IMAGE_FSTYPES += "cpio.gz"
INITRAMFS_IMAGE ?= "core-image-minimal"
IMAGE_NAME_SUFFIX = ""

SERIAL_CONSOLES = "115200;ttyAMA0"

EXTRA_IMAGEDEPENDS += "trusted-firmware-a optee-os"

# FIXME - there is signed image dependency/race with testimage.
# This should be fixed in oe-core
TESTIMAGEDEPENDS:append = " virtual/kernel:do_deploy"

TEST_TARGET = "OEFVPTarget"
TEST_SUITES = "fvp_boot"

# FVP Config
FVP_PROVIDER ?= "fvp-tc2-native"
FVP_EXE ?= "FVP_TC2"

# FVP Parameters
FVP_CONFIG[css.scp.ROMloader.fname] ?= "scp_romfw.bin"
FVP_CONFIG[css.trustedBootROMloader.fname] ?= "bl1-tc.bin"
FVP_CONFIG[board.flashloader0.fname] ?= "fip_gpt-tc.bin"

#FVP_CONFIG[board.hostbridge.userNetworking] ?= "true"
#FVP_CONFIG[board.hostbridge.userNetPorts] ?= "2222=22"
#smsc ethernet takes a very long time to come up.  disable now to prevent testimage timeout
#FVP_CONFIG[board.smsc_91c111.enabled] ?= "1"

FVP_CONSOLE = "terminal_s1"
FVP_TERMINALS[soc.terminal_s0] ?= "Secure Console"
FVP_TERMINALS[soc.terminal_s1] ?= "Console"

# Boot image
FVP_DATA ?= "board.dram=fitImage-core-image-minimal-tc2-tc2@0x20000000"
```

## meta-arm-bsp/wic/arm-reference-image.corstone700.wks
```
# WIC partitioning for corstone700
# Layout and maximum sizes:
#
# SPITOC: 1 KB
# SE Ram FW: 32 KB
# FIP image: 991 KB (composed of FIPTOC, BL32 and DTB)
# XIP Cramfs rootfs: 2 MB
# XIP Linux kernel: 3 MB
#

part --source rawcopy --sourceparams="file=spitoc.bin" --no-table --align 1 --fixed-size 1k

part --source rawcopy --sourceparams="file=se_ramfw.bin" --no-table --align 1 --fixed-size 32k

# Rawcopy of the FIP binary
part --source rawcopy --sourceparams="file=fip.bin-corstone700" --no-table --align 1 --fixed-size 991k

# Rawcopy of the rootfs
part --source rawcopy --sourceparams="file=${IMGDEPLOYDIR}/arm-reference-image-${MACHINE}.cramfs-xip" --no-table --fixed-size 2

# Rawcopy of the kernel binary
part --source rawcopy --sourceparams="file=xipImage" --no-table --fixed-size 4
```

## meta-arm-bsp/wic/fvp-base.wks
```
# For fvp-base* machines we just need to populate the rootfs partition
# but to keep backwards compatibility with disk.img,
# we need to create first partition empty

part --label empty --source empty --ondisk sda --size="1M" --system-id 8e --align 1024
part / --source rootfs --ondisk sda --fstype=ext4 --label root --size="2048"
```

## meta-arm-bsp/wic/fvp-baser-aemv8r64.wks
```
# For fvp-baser-aemv8r64 machine we just need to populate the rootfs partition

part / --source rootfs --ondisk sda --fstype=ext4 --label root --align 1024 --extra-space 100
```

## meta-arm-integration/conf/layer.conf
```bitbake
# We have a conf and classes directory, add to BBPATH
BBPATH .= ":${LAYERDIR}"

# We have recipes-* directories, add to BBFILES
BBFILES += "${LAYERDIR}/recipes-*/*/*.bb \
            ${LAYERDIR}/recipes-*/*/*.bbappend"

BBFILE_COLLECTIONS += "meta-arm-integration"
BBFILE_PATTERN_meta-arm-integration = "^${LAYERDIR}/"
BBFILE_PRIORITY_meta-arm-integration = "6"

LAYERDEPENDS_meta-arm-integration = "core"
LAYERSERIES_COMPAT_meta-arm-integration = "warrior"
```

## meta-arm-iota/conf/layer.conf
```bitbake
# We have a conf and classes directory, add to BBPATH
BBPATH .= ":${LAYERDIR}"

# We have recipes-* directories, add to BBFILES
BBFILES += "${LAYERDIR}/recipes-*/*/*.bb \
            ${LAYERDIR}/recipes-*/*/*.bbappend"

BBFILE_COLLECTIONS += "meta-arm-iota"
BBFILE_PATTERN_meta-arm-iota = "^${LAYERDIR}/"
BBFILE_PRIORITY_meta-arm-iota = "6"

LAYERDEPENDS_meta-arm-iota = "core"
LAYERSERIES_COMPAT_meta-arm-iota = "warrior zeus"
```

## meta-arm-toolchain/conf/layer.conf
```bitbake
BBPATH .= ":${LAYERDIR}"
BBFILES += "\
            ${LAYERDIR}/recipes-*/*/*.bb \
            ${LAYERDIR}/recipes-*/*/*.bbappend \
           "

BBFILE_COLLECTIONS += "arm-toolchain"
BBFILE_PATTERN_arm-toolchain := "^${LAYERDIR}/"
BBFILE_PRIORITY_arm-toolchain = "30"

# Additional license directories.
LICENSE_PATH += "${LAYERDIR}/custom-licenses"

LAYERDEPENDS_arm-toolchain = "core"
LAYERSERIES_COMPAT_arm-toolchain = "zeus dunfell"

# These variables are used for armcompiler license
BB_HASHBASE_WHITELIST_append = " ARM_TOOL_VARIANT ARMLMD_LICENSE_FILE LM_LICENSE_FILE"
```

## meta-arm/conf/layer.conf
```bitbake
# We have a conf and classes directory, add to BBPATH
BBPATH .= ":${LAYERDIR}"

# We have recipes-* directories, add to BBFILES
BBFILES += "${LAYERDIR}/recipes-*/*/*.bb \
            ${LAYERDIR}/recipes-*/*/*.bbappend"

BBFILE_COLLECTIONS += "meta-arm"
BBFILE_PATTERN_meta-arm = "^${LAYERDIR}/"
BBFILE_PRIORITY_meta-arm = "6"

LAYERDEPENDS_meta-arm = " \
    core \
    arm-toolchain \
"
LAYERSERIES_COMPAT_meta-arm = "warrior zeus dunfell"
```

## meta-arm/conf/machine/generic-arm64.conf
```bitbake
#@TYPE: Machine
#@NAME: generic-arm64
#@DESCRIPTION: Generic Arm64 machine for typical SystemReady platforms, which
#have working firmware and boot via EFI.

require conf/machine/include/arm/arch-armv8a.inc

PREFERRED_PROVIDER_virtual/kernel ?= "linux-yocto"
# Newer versions of the kernel are not booting on QEMU.  Hold it back to a
#  known working version until it is determined why
PREFERRED_VERSION_linux-yocto ?= "5.10%"
KBUILD_DEFCONFIG = "defconfig"
KCONFIG_MODE = "--alldefconfig"
KERNEL_IMAGETYPE = "Image"
MACHINE_EXTRA_RRECOMMENDS += "kernel-modules linux-firmware"

IMAGE_FSTYPES ?= "wic"
WKS_FILE ?= "efi-disk.wks.in"
EFI_PROVIDER ?= "${@bb.utils.contains("DISTRO_FEATURES", "systemd", "systemd-boot", "grub-efi", d)}"

MACHINE_FEATURES:append = " alsa bluetooth efi qemu-usermode rtc screen usbhost vfat wifi"
```

## meta-arm/conf/machine/include/arm/arch-armv8-7a.inc
```bitbake
DEFAULTTUNE ?= "armv8-7a"

TUNEVALID[armv8-7a] = "Enable instructions for ARMv8.7-a"
TUNE_CCARGS_MARCH .= "${@bb.utils.contains('TUNE_FEATURES', 'armv8-7a', ' -march=armv8.7-a', '', d)}"
# TUNE crypto will be handled by arch-armv8a.inc below
MACHINEOVERRIDES =. "${@bb.utils.contains('TUNE_FEATURES', 'armv8-7a', 'armv8-7a:', '', d)}"

require conf/machine/include/arm/arch-armv8a.inc
require conf/machine/include/arm/feature-arm-sve.inc

# Little Endian base configs
AVAILTUNES += "armv8-7a armv8-7a-crypto armv8-7a-crypto-sve"
ARMPKGARCH:tune-armv8-7a                    ?= "armv8-7a"
ARMPKGARCH:tune-armv8-7a-crypto             ?= "armv8-7a"
ARMPKGARCH:tune-armv8-7a-crypto-sve         ?= "armv8-7a"
TUNE_FEATURES:tune-armv8-7a                  = "aarch64 armv8-7a"
TUNE_FEATURES:tune-armv8-7a-crypto           = "${TUNE_FEATURES:tune-armv8-7a} crypto"
TUNE_FEATURES:tune-armv8-7a-crypto-sve       = "${TUNE_FEATURES:tune-armv8-7a-crypto} sve"
PACKAGE_EXTRA_ARCHS:tune-armv8-7a            = "${PACKAGE_EXTRA_ARCHS:tune-armv8a} armv8-7a"
PACKAGE_EXTRA_ARCHS:tune-armv8-7a-crypto     = "${PACKAGE_EXTRA_ARCHS:tune-armv8-7a} armv8-7a-crypto"
PACKAGE_EXTRA_ARCHS:tune-armv8-7a-crypto-sve = "${PACKAGE_EXTRA_ARCHS:tune-armv8-7a-crypto} armv8-7a-crypto-sve"
BASE_LIB:tune-armv8-7a                       = "lib64"
BASE_LIB:tune-armv8-7a-crypto                = "lib64"
BASE_LIB:tune-armv8-7a-crypto-sve            = "lib64"
```
