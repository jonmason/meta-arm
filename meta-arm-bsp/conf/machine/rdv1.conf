## meta-arm/conf/machine/include/arm/arch-armv8-8a.inc
```bitbake
DEFAULTTUNE ?= "armv8-8a"

TUNEVALID[armv8-8a] = "Enable instructions for ARMv8.8-a"
TUNE_CCARGS_MARCH .= "${@bb.utils.contains('TUNE_FEATURES', 'armv8-8a', ' -march=armv8.8-a', '', d)}"
# TUNE crypto will be handled by arch-armv8a.inc below
MACHINEOVERRIDES =. "${@bb.utils.contains('TUNE_FEATURES', 'armv8-8a', 'armv8-8a:', '', d)}"

require conf/machine/include/arm/arch-armv8a.inc
require conf/machine/include/arm/feature-arm-sve.inc

# Little Endian base configs
AVAILTUNES += "armv8-8a armv8-8a-crypto armv8-8a-crypto-sve"
ARMPKGARCH:tune-armv8-8a                    ?= "armv8-8a"
ARMPKGARCH:tune-armv8-8a-crypto             ?= "armv8-8a"
ARMPKGARCH:tune-armv8-8a-crypto-sve         ?= "armv8-8a"
TUNE_FEATURES:tune-armv8-8a                  = "aarch64 armv8-8a"
TUNE_FEATURES:tune-armv8-8a-crypto           = "${TUNE_FEATURES:tune-armv8-8a} crypto"
TUNE_FEATURES:tune-armv8-8a-crypto-sve       = "${TUNE_FEATURES:tune-armv8-8a-crypto} sve"
PACKAGE_EXTRA_ARCHS:tune-armv8-8a            = "${PACKAGE_EXTRA_ARCHS:tune-armv8a} armv8-8a"
PACKAGE_EXTRA_ARCHS:tune-armv8-8a-crypto     = "${PACKAGE_EXTRA_ARCHS:tune-armv8-8a} armv8-8a-crypto"
PACKAGE_EXTRA_ARCHS:tune-armv8-8a-crypto-sve = "${PACKAGE_EXTRA_ARCHS:tune-armv8-8a-crypto} armv8-8a-crypto-sve"
BASE_LIB:tune-armv8-8a                       = "lib64"
BASE_LIB:tune-armv8-8a-crypto                = "lib64"
BASE_LIB:tune-armv8-8a-crypto-sve            = "lib64"
```

## meta-arm/conf/machine/include/arm/arch-armv8-9a.inc
```bitbake
DEFAULTTUNE ?= "armv8-9a"

TUNEVALID[armv8-9a] = "Enable instructions for ARMv8.9-a"
TUNE_CCARGS_MARCH .= "${@bb.utils.contains('TUNE_FEATURES', 'armv8-9a', ' -march=armv8.9-a', '', d)}"
# TUNE crypto will be handled by arch-armv8a.inc below
MACHINEOVERRIDES =. "${@bb.utils.contains('TUNE_FEATURES', 'armv8-9a', 'armv8-9a:', '', d)}"

require conf/machine/include/arm/arch-armv8a.inc
require conf/machine/include/arm/feature-arm-sve.inc

# Little Endian base configs
AVAILTUNES += "armv8-9a armv8-9a-crypto armv8-9a-crypto-sve"
ARMPKGARCH:tune-armv8-9a                    ?= "armv8-9a"
ARMPKGARCH:tune-armv8-9a-crypto             ?= "armv8-9a"
ARMPKGARCH:tune-armv8-9a-crypto-sve         ?= "armv8-9a"
TUNE_FEATURES:tune-armv8-9a                  = "aarch64 armv8-9a"
TUNE_FEATURES:tune-armv8-9a-crypto           = "${TUNE_FEATURES:tune-armv8-9a} crypto"
TUNE_FEATURES:tune-armv8-9a-crypto-sve       = "${TUNE_FEATURES:tune-armv8-9a-crypto} sve"
PACKAGE_EXTRA_ARCHS:tune-armv8-9a            = "${PACKAGE_EXTRA_ARCHS:tune-armv8a} armv8-9a"
PACKAGE_EXTRA_ARCHS:tune-armv8-9a-crypto     = "${PACKAGE_EXTRA_ARCHS:tune-armv8-9a} armv8-9a-crypto"
PACKAGE_EXTRA_ARCHS:tune-armv8-9a-crypto-sve = "${PACKAGE_EXTRA_ARCHS:tune-armv8-9a-crypto} armv8-9a-crypto-sve"
BASE_LIB:tune-armv8-9a                       = "lib64"
BASE_LIB:tune-armv8-9a-crypto                = "lib64"
BASE_LIB:tune-armv8-9a-crypto-sve            = "lib64"
```

## meta-arm/conf/machine/qemuarm64-sbsa.conf
```bitbake
#@TYPE: Machine
#@NAME: qemuarm64_sbsa
#@DESCRIPTION: QEMU Machine for Arm Server Base System Architecture

MACHINEOVERRIDES =. "qemuarm64:"

require ${COREBASE}/meta/conf/machine/qemuarm64.conf

KMACHINE = "qemuarm64"

QB_MACHINE = "-machine sbsa-ref"
QB_MEM = "-m 1024"
QB_DEFAULT_FSTYPE = "wic.qcow2"
QB_NETWORK_DEVICE = ""
QB_DRIVE_TYPE = "/dev/hd"
QB_ROOTFS_OPT = "-drive file=@ROOTFS@,if=ide,format=qcow2"
QB_DEFAULT_KERNEL = "none"
QB_OPT_APPEND = "-device qemu-xhci -device usb-tablet -device usb-kbd"

IMAGE_BOOT_FILES = "${KERNEL_IMAGETYPE}"
IMAGE_FSTYPES += "wic wic.qcow2"

WKS_FILE ?= "mkefidisk.wks"

MACHINE_FEATURES += "efi"

EXTRA_IMAGEDEPENDS += "edk2-firmware"

KBUILD_DEFCONFIG = "defconfig"
KCONFIG_MODE = "--alldefconfig"
```

## meta-arm/conf/machine/qemuarm64-secureboot.conf
```bitbake
MACHINEOVERRIDES =. "qemuarm64:"

require ${COREBASE}/meta/conf/machine/qemuarm64.conf

KMACHINE = "qemuarm64"

UBOOT_MACHINE = "qemu_arm64_defconfig"

QB_MACHINE = "-machine virt,secure=on"
QB_OPT_APPEND += "-no-acpi"
QB_MEM = "-m 1024"
QB_DEFAULT_FSTYPE = "wic.qcow2"
QB_DEFAULT_BIOS = "flash.bin"
QB_FSINFO = "wic:no-kernel-in-fs"
QB_ROOTFS_OPT = ""

IMAGE_FSTYPES += "wic wic.qcow2"

WKS_FILE ?= "qemuarm64.wks"
WKS_FILE_DEPENDS = "trusted-firmware-a"
IMAGE_BOOT_FILES = "${KERNEL_IMAGETYPE}"

PREFERRED_VERSION_linux-yocto ?= "5.10%"
```

## meta-corstone700/conf/distro/iota-tiny.conf
```bitbake
# SPDX-License-Identifier: Apache-2.0
#
# Copyright (c) 2018 ARM Limited
#
# Iota OpenEmbedded distribution configuration file
#

require conf/distro/poky-tiny.conf

DISTRO_NAME = "Iota - Tiny Linux Distribution"
DISTRO = "iota-tiny"
DISTRO_VERSION = "0.1"

INHERIT += "image-buildinfo"

TCLIBC = "musl"
```

## meta-corstone700/conf/layer.conf
```bitbake
# SPDX-License-Identifier: Apache-2.0
#
# Copyright (c) 2019 Arm Limited
#
# corstone700 has a conf and classes directory, add to BBPATH
BBPATH .= ":${LAYERDIR}"

# corstone700 has a packages directory, add to BBFILES
BBFILES += " \
		${LAYERDIR}/recipes-*/*/*.bb \
		${LAYERDIR}/recipes-*/*/*.bbappend"

BBFILE_COLLECTIONS += "corstone700"
BBFILE_PATTERN_corstone700 := "^${LAYERDIR}/"
BBFILE_PRIORITY_corstone700 = "12"
LAYERSERIES_COMPAT_corstone700 = "warrior"

NAME_GCC_ARM_NONE_EABI 		= "gcc-arm-none-eabi"
INSTALL_GCC_ARM_NONE_EABI 	= "${bindir}/${NAME_GCC_ARM_NONE_EABI}"
TC_GCC_ARM_NONE_EABI		= "${STAGING_BINDIR_NATIVE}/${NAME_GCC_ARM_NONE_EABI}"
TC_GCC_ARM_NONE_EABI_BIN 	= "${TC_GCC_ARM_NONE_EABI}/bin"

LAYERDEPENDS_corstone700 = "arm"
```

## meta-corstone700/conf/machine/corstone700.conf
```bitbake
# SPDX-License-Identifier: MIT
#
# Copyright (c) 2019 Arm Limited
#

require conf/machine/include/arm-common-configuration.inc
require conf/machine/include/cortex-a32.inc

EXTRA_IMAGEDEPENDS_append = " test-app"

CORE_IMAGE_EXTRA_INSTALL += "test-app"

EXTRA_IMAGEDEPENDS_append = " boot-firmware external-system"

TF-A_PLATFORM = "corstone700"
TF-A_EXTRA_OPTIONS += " \
			RESET_TO_SP_MIN=1 \
			ARM_LINUX_KERNEL_AS_BL33=1 \
			PRELOADED_BL33_BASE=0x08300000 \
			ARM_PRELOADED_DTB_BASE=0x02800000 \
			ENABLE_STACK_PROTECTOR=strong \
			ENABLE_PIE=1 \
			"
```

## meta-corstone700/wic/iota-tiny-image.corstone700.wks
```
# Partition for corstone700
part --source rawcopy --sourceparams="file=spitoc.bin" --no-table --align 1 --fixed-size 1k

part --source rawcopy --sourceparams="file=se_ramfw.bin" --no-table --align 1 --fixed-size 32k

# Rawcopy of the FIP binary
part --source rawcopy --sourceparams="file=corstone700.fip" --no-table --align 1 --fixed-size 991k

# Rawcopy of the rootfs
part --source rawcopy --sourceparams="file=${IMGDEPLOYDIR}/iota-tiny-image-corstone700.cpio.gz" --no-table --fixed-size 4

# Rawcopy of the kernel binary
part --source rawcopy --sourceparams="file=xipImage" --no-table --fixed-size 3
```

## meta-designstart/conf/layer.conf
```bitbake
# SPDX-License-Identifier: MIT
#
# Copyright (c) 2019 Arm Limited
#

# designstart has a conf and classes directory, add to BBPATH
BBPATH .= ":${LAYERDIR}"

# designstart has a packages directory, add to BBFILES
BBFILES += " \
		${LAYERDIR}/recipes-*/*/*.bb \
		${LAYERDIR}/recipes-*/*/*.bbappend"

BBFILE_COLLECTIONS += "designstart"
BBFILE_PATTERN_designstart := "^${LAYERDIR}/"
BBFILE_PRIORITY_designstart = "12"
LAYERSERIES_COMPAT_designstart = "warrior"

LAYERDEPENDS_vexpress = "arm"
```

## meta-designstart/conf/machine/a5ds.conf
```bitbake
# SPDX-License-Identifier: MIT
#
# Copyright (c) 2019 Arm Limited
#

require conf/machine/include/arm-common-configuration.inc
require conf/machine/include/cortex-a5.inc

TF-A_PLATFORM = "a5ds"
TF-A_EXTRA_OPTIONS += " FVP_HW_CONFIG_DTS=fdts/a5ds.dts"
TF-A_DEPENDS += "u-boot u-boot-mkimage-native"
TF-A_BL33 = "${DEPLOY_DIR_IMAGE}/u-boot.${UBOOT_SUFFIX}"

SERIAL_CONSOLES ?= "115200;ttyAMA0"

KBUILD_DEFCONFIG = "multi_v7_defconfig"

EXTRA_IMAGEDEPENDS_append = " u-boot"
```

## meta-designstart/wic/iota-tiny-image.a5ds.wks
```
# Partition for a5ds
  
# Rawcopy of the FIP binary
part --source rawcopy --sourceparams="file=a5ds.fip" --no-table --align 1 --fixed-size 1

# Rawcopy of the kernel binary
part --source rawcopy --sourceparams="file=zImage" --no-table --fixed-size 12

# Rawcopy of the rootfs
part --source rawcopy --sourceparams="file=${IMGDEPLOYDIR}/iota-tiny-image-a5ds.initramfs.cpio.gz" --no-table
```
