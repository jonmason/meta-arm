## meta-arm-bsp/conf/machine/include/tune-cortexm23.inc
```bitbake
#
# Tune Settings for Cortex-M23
#
DEFAULTTUNE ?= "cortexm23"

TUNEVALID[cortexm23] = "Enable Cortex-M23 specific processor optimizations"
TUNE_CCARGS .= "${@bb.utils.contains('TUNE_FEATURES', 'cortexm23', ' -mcpu=cortex-m23', '', d)}"

require conf/machine/include/arm/arch-armv8m-base.inc


AVAILTUNES                          += "cortexm23"
ARMPKGARCH_tune-cortexm23            = "cortexm23"
TUNE_FEATURES_tune-cortexm23         = "${TUNE_FEATURES_tune-armv8m-base} cortexm23"
PACKAGE_EXTRA_ARCHS_tune-cortexm23   = "${PACKAGE_EXTRA_ARCHS_tune-armv8m-base} cortexm23"
```

## meta-arm-bsp/conf/machine/include/tune-cortexm3.inc
```bitbake
#
# Tune Settings for Cortex-M3
#
DEFAULTTUNE ?= "cortexm3"

TUNEVALID[cortexm3] = "Enable Cortex-M3 specific processor optimizations"
TUNE_CCARGS .= "${@bb.utils.contains('TUNE_FEATURES', 'cortexm3', ' -mcpu=cortex-m3', '', d)}"

require conf/machine/include/arm/arch-armv7m.inc


AVAILTUNES                            += "cortexm3"
ARMPKGARCH_tune-cortexm3               = "cortexm3"
TUNE_FEATURES_tune-cortexm3            = "${TUNE_FEATURES_tune-armv7m} cortexm3"
PACKAGE_EXTRA_ARCHS_tune-cortexm3      = "${PACKAGE_EXTRA_ARCHS_tune-armv7m} cortexm3"
```

## meta-arm-bsp/conf/machine/include/tune-cortexm33.inc
```bitbake
#
# Tune Settings for Cortex-M33
#
DEFAULTTUNE ?= "armv8m"

TUNEVALID[armv8m] = "Enable instructions for ARMv8-m"
TUNE_CCARGS .= "${@bb.utils.contains('TUNE_FEATURES', 'armv8m', ' -march=armv7-m', '', d)}"

require conf/machine/include/arm/arch-armv8m-main.inc

AVAILTUNES += "armv8m"
ARMPKGARCH_tune-armv8m ?= "armv8m"
TUNE_FEATURES_tune-armv8m = "armv8m"
PACKAGE_EXTRA_ARCHS_tune-armv8m = "armv8m"
```

## meta-arm-bsp/conf/machine/include/tune-cortexm35p.inc
```bitbake
#
# Tune Settings for Cortex-M35P
#
DEFAULTTUNE ?= "cortexm33p"

TUNEVALID[cortexm35p] = "Enable Cortex-M35p specific processor optimizations"
TUNE_CCARGS .= "${@bb.utils.contains('TUNE_FEATURES', 'cortexm35p', ' -mcpu=cortex-m35p', '', d)}"

require conf/machine/include/arm/arch-armv8m-main.inc


AVAILTUNES                          += "cortexm35p"
ARMPKGARCH_tune-cortexm35p           = "cortexm35p"
TUNE_FEATURES_tune-cortexm35p        = "${TUNE_FEATURES_tune-armv8m-main} cortexm35p"
PACKAGE_EXTRA_ARCHS_tune-cortexm35p  = "${PACKAGE_EXTRA_ARCHS_tune-armv8m-main} cortexm35p"
```

## meta-arm-bsp/conf/machine/include/tune-cortexm4.inc
```bitbake
#
# Tune Settings for Cortex-M4
#
DEFAULTTUNE ?= "cortexm4"

TUNEVALID[cortexm4] = "Enable Cortex-M4 specific processor optimizations"
TUNE_CCARGS .= "${@bb.utils.contains('TUNE_FEATURES', 'cortexm4', ' -mcpu=cortex-m4', '', d)}"

require conf/machine/include/arm/arch-armv7em.inc

AVAILTUNES                            += "cortexm4"
ARMPKGARCH_tune-cortexm4               = "cortexm4"
TUNE_FEATURES_tune-cortexm4            = "${TUNE_FEATURES_tune-armv7em} cortexm4"
PACKAGE_EXTRA_ARCHS_tune-cortexm4      = "${PACKAGE_EXTRA_ARCHS_tune-armv7em} cortexm4"
```

## meta-arm-bsp/conf/machine/include/tune-cortexm55.inc
```bitbake
#
# Tune Settings for Cortex-M55
#
DEFAULTTUNE ?= "cortexm55"

TUNEVALID[cortexm55] = "Enable Cortex-M55 specific processor optimizations"
TUNE_CCARGS .= "${@bb.utils.contains('TUNE_FEATURES', 'cortexm55', ' -mcpu=cortex-m55', '', d)}"

require conf/machine/include/arm/arch-armv8-1m-main.inc


AVAILTUNES                            += "cortexm55"
ARMPKGARCH_tune-cortexm55              = "cortexm55"
TUNE_FEATURES_tune-cortexm55           = "${TUNE_FEATURES_tune-armv8-1m-main} cortexm55"
PACKAGE_EXTRA_ARCHS_tune-cortexm55     = "${PACKAGE_EXTRA_ARCHS_tune-armv8-1m-main} cortexm55"
```

## meta-arm-bsp/conf/machine/juno.conf
```bitbake
# Configuration for juno development board

#@TYPE: Machine
#@NAME: Juno machine
#@DESCRIPTION: Machine configuration for Juno

TUNE_FEATURES = "aarch64"

require conf/machine/include/arm/arch-armv8a.inc

MACHINE_FEATURES = "usbhost usbgadget alsa screen wifi bluetooth optee pci"

KERNEL_IMAGETYPE = "Image"
KERNEL_DEVICETREE = "arm/juno.dtb arm/juno-r1.dtb arm/juno-r2.dtb"

IMAGE_FSTYPES += "tar.bz2 ext4"

SERIAL_CONSOLES = "115200;ttyAMA0"

# Use kernel provided by yocto
PREFERRED_PROVIDER_virtual/kernel ?= "linux-yocto"
PREFERRED_VERSION_linux-yocto ?= "5.4%"
PREFERRED_VERSION_trusted-firmware-a ?= "2.5%"
PREFERRED_VERSION_u-boot ?= "2020.07"

EXTRA_IMAGEDEPENDS += "virtual/trusted-firmware-a u-boot firmware-image-juno"

# Juno u-boot configuration
UBOOT_MACHINE = "vexpress_aemv8a_juno_defconfig"
```

## meta-arm-bsp/conf/machine/musca-b1.conf
```bitbake
# Configuration for Musca-B1 development board

#@TYPE: Machine
#@NAME: Musca-B1 machine
#@DESCRIPTION: Machine configuration for Musca-B1

EXTRA_IMAGEDEPENDS += "virtual/trusted-firmware-m"
PREFERRED_VERSION_trusted-firmware-m = "1.0"

require conf/machine/include/tune-cortexm33.inc

# GLIBC will not work with Cortex-M.
TCLIBC = "baremetal"
```

## meta-arm-bsp/conf/machine/musca-s1.conf
```bitbake
# Configuration for Musca-S1 development board

#@TYPE: Machine
#@NAME: Musca-S1 machine
#@DESCRIPTION: Machine configuration for Musca-S1

require conf/machine/include/arm/armv8-m/tune-cortexm33.inc

# GLIBC will not work with Cortex-M.
TCLIBC = "newlib"

TFM_PLATFORM = "musca_s1"
```

## meta-arm-bsp/conf/machine/n1sdp.conf
```bitbake
# Configuration for Arm N1SDP development board

#@TYPE: Machine
#@NAME: N1SDP machine
#@DESCRIPTION: Machine configuration for N1SDP

require conf/machine/include/arm/armv8-2a/tune-neoversen1.inc

KERNEL_IMAGETYPE = "Image"

IMAGE_FSTYPES += "wic wic.gz wic.bmap tar.bz2 ext4"

SERIAL_CONSOLES = "115200;ttyAMA0"

# Set default WKS
WKS_FILE ?= "n1sdp-efidisk.wks"
IMAGE_EFI_BOOT_FILES ?= "n1sdp-multi-chip.dtb n1sdp-single-chip.dtb"
WKS_FILE_DEPENDS:append = " ${EXTRA_IMAGEDEPENDS}"

# Use kernel provided by yocto
PREFERRED_PROVIDER_virtual/kernel ?= "linux-yocto"
PREFERRED_VERSION_linux-yocto ?= "6.1%"

# RTL8168E Gigabit Ethernet Controller is attached to the PCIe interface
MACHINE_ESSENTIAL_EXTRA_RDEPENDS += "linux-firmware-rtl8168"

EXTRA_IMAGEDEPENDS += "trusted-firmware-a"
EXTRA_IMAGEDEPENDS += "virtual/control-processor-firmware"

#UEFI EDK2 firmware
EXTRA_IMAGEDEPENDS += "edk2-firmware"
PREFERRED_VERSION_edk2-firmware ?= "202211"

#optee
PREFERRED_VERSION_optee-os ?= "3.20.%"

#grub-efi
EFI_PROVIDER ?= "grub-efi"
MACHINE_FEATURES += "efi"

# SD-Card firmware
EXTRA_IMAGEDEPENDS += "sdcard-image-n1sdp"


# As this is a virtual target that will not be used in the real world there is
# no need for real SSH keys.
MACHINE_EXTRA_RRECOMMENDS += "ssh-pregen-hostkeys"

TEST_TARGET = "OEFVPTarget"
TEST_TARGET_IP = "127.0.0.1:8022"

# FVP Config
FVP_PROVIDER ?= "fvp-neoverse-v1-native"
FVP_EXE ?= "FVP_RD_V1"

# FVP Parameters
FVP_DATA ?= "css.scp.armcortexm7ct=${DEPLOY_DIR_IMAGE}/scp_ramfw.bin@0x0BD80000"
FVP_CONFIG[css.scp.ROMloader.fname] ?= "${DEPLOY_DIR_IMAGE}/scp_romfw.bin"
FVP_CONFIG[css.mcp.ROMloader.fname] ?= "${DEPLOY_DIR_IMAGE}/mcp_romfw.bin"
FVP_CONFIG[css.trustedBootROMloader.fname] ?= "${DEPLOY_DIR_IMAGE}/bl1-n1sdp.bin"
FVP_CONFIG[board.flashloader0.fname] ?= "${DEPLOY_DIR_IMAGE}/fip-n1sdp.bin"

FVP_CONFIG[board.virtio_net.enabled] ?= "1"
FVP_CONFIG[board.virtio_net.hostbridge.userNetworking] ?= "1"
FVP_CONFIG[board.virtio_net.hostbridge.userNetPorts] = "8022=22"

FVP_CONSOLE = "terminal_s0"
FVP_TERMINALS[soc.terminal_s0] ?= "Secure Console"
FVP_TERMINALS[soc.terminal_s1] ?= "Console"

# Boot image
FVP_CONFIG[board.virtioblockdevice.image_path] ?= "${DEPLOY_DIR_IMAGE}/${IMAGE_NAME}.rootfs.wic"
```

## meta-arm-bsp/conf/machine/rd-v2.conf
```bitbake
# Configuration for Arm Neoverse V2 development board

#@TYPE: Machine
#@NAME: rd-v2
#@DESCRIPTION: Machine configuration for Neoverse V2

require conf/machine/include/arm/arch-armv9a.inc

EXTRA_IMAGEDEPENDS += "virtual/control-processor-firmware"
EXTRA_IMAGEDEPENDS += "trusted-firmware-a"

KERNEL_IMAGETYPE ?= "Image"
PREFERRED_PROVIDER_virtual/kernel ?= "linux-yocto"
SERIAL_CONSOLES = "115200;ttyAMA0"

#grub-efi
EFI_PROVIDER ?= "grub-efi"
MACHINE_FEATURES += "efi"

IMAGE_FSTYPES += "cpio.gz wic"

WKS_FILE ?= "efi-disk.wks.in"
EFI_PROVIDER ?= "${@bb.utils.contains("DISTRO_FEATURES", "systemd", "systemd-boot", "grub-efi", d)}"
WKS_FILE_DEPENDS:append = " ${EXTRA_IMAGEDEPENDS}"


#FVP Config
TEST_TARGET = "OEFVPTarget"
TEST_SUITES = "fvp_boot"

# FVP Config
FVP_PROVIDER ?= "fvp-rd-v2-native"
FVP_EXE ?= "FVP_RD_V2"

# FVP Parameters
FVP_DATA ?= "css.scp.armcortexm7ct=scp_ramfw.bin@0x0BD80000"
FVP_CONFIG[css.mcp.ROMloader.fname] ?= "mcp_romfw.bin"
FVP_CONFIG[css.scp.ROMloader.fname] ?= "scp_romfw.bin"
FVP_CONFIG[css.trustedBootROMloader.fname] ?= "bl1-rdn2.bin"
FVP_CONFIG[board.flashloader0.fname] ?= "fip-rdn2.bin"

FVP_CONFIG[board.virtio_net.enabled] ?= "1"
FVP_CONFIG[board.virtio_net.hostbridge.userNetworking] ?= "1"
# Tell testimage to connect to localhost:2222, and forward that to SSH in the FVP.
FVP_CONFIG[board.virtio_net.hostbridge.userNetPorts] = "2222=22"

FVP_CONSOLE = "terminal_s0"
FVP_TERMINALS[soc.terminal_s0] ?= "Secure Console"
FVP_TERMINALS[soc.terminal_s1] ?= "Console"
#FVP_TERMINALS[soc.terminal_mcp] ?= "MCP Console"

# Boot image
FVP_CONFIG[board.virtioblockdevice.image_path] ?= "${IMAGE_NAME}.wic"

FVP_CONFIG[css.cmn_kampos.force_rnsam_internal] = "true"
FVP_CONFIG[css.gic_distributor.ITS-device-bits] = "20"
```

## meta-arm-bsp/conf/machine/rdn2.conf
```bitbake
# Configuration for Arm Neoverse N2 Reference Design development board

#@TYPE: Machine
#@NAME: RD N2
#@DESCRIPTION: Machine configuration for RD N2

require conf/machine/include/arm/armv9a/tune-neoversen2.inc

EXTRA_IMAGEDEPENDS += "virtual/control-processor-firmware"
EXTRA_IMAGEDEPENDS += "trusted-firmware-a"

KERNEL_IMAGETYPE ?= "Image"
PREFERRED_PROVIDER_virtual/kernel = "linux-yocto"
#PREFERRED_PROVIDER_virtual/kernel:forcevariable = "linux-yocto"
SERIAL_CONSOLES = "115200;ttyAMA2"
EXTRA_IMAGEDEPENDS += "edk2-firmware"

EFI_PROVIDER ?= "${@bb.utils.contains("DISTRO_FEATURES", "systemd", "systemd-boot", "grub-efi", d)}"
MACHINE_FEATURES += "efi"

IMAGE_FSTYPES:forcevariable = "cpio.gz wic"
IMAGE_NAME_SUFFIX = ""
IMAGE_CLASSES += "fvpboot"

WKS_FILE ?= "efi-disk.wks.in"
WKS_FILE_DEPENDS:append = " ${EXTRA_IMAGEDEPENDS}"

# testimage config
TEST_TARGET = "OEFVPTarget"
#TEST_TARGET_IP = "127.0.0.1:2222"
TEST_SUITES = "fvp_boot"
#DEFAULT_TEST_SUITES:append = " fvp_boot fvp_devices"
#TEST_FVP_DEVICES ?= "rtc watchdog networking virtiorng cpu_hotplug"

# FVP Config
FVP_PROVIDER ?= "fvp-rdn2-native"
FVP_EXE ?= "FVP_RD_N2"

FVP_DATA ?= "css.scp.armcortexm7ct=scp_ramfw.bin@0x0BD80000 \
             css.mcp.armcortexm7ct=mcp_ramfw.bin@0x0BF80000"

FVP_CONFIG[css.gic_distributor.ITS-device-bits] ?= "20"
FVP_CONFIG[css.mcp.ROMloader.fname] ?= "mcp_romfw.bin"
FVP_CONFIG[css.scp.ROMloader.fname] ?= "scp_romfw.bin"
FVP_CONFIG[css.trustedBootROMloader.fname] ?= "bl1-rdn2.bin"
FVP_CONFIG[board.flashloader0.fname] ?= "fip-rdn2.bin"

FVP_CONFIG[board.dram_size] ?= "0x200000000"

# Virtio configuration
FVP_CONFIG[board.virtio_net.enabled] ?= "1"
FVP_CONFIG[board.virtio_net.hostbridge.userNetworking] ?= "1"
FVP_CONFIG[board.virtio_net.hostbridge.userNetPorts] = "2222=22"
FVP_CONFIG[board.virtioblockdevice.image_path] ?= "${IMAGE_NAME}.wic"

FVP_CONSOLES[default] = "terminal_ns_uart_ap"
FVP_TERMINALS[css.scp.terminal_uart_scp] ?= "SCP Console"
FVP_TERMINALS[css.mcp.terminal_uart_mcp] ?= "MCP Console"
FVP_TERMINALS[css.terminal_ns_uart_ap] ?= "Console"
FVP_TERMINALS[css.terminal_s_uart_ap] ?= ""
#FVP_TERMINALS[soc.nonPCIe_devices_iomacro.iomacro_terminal_0] ?= ""
#FVP_TERMINALS[soc.nonPCIe_devices_iomacro.iomacro_terminal_1] ?= ""
#FVP_TERMINALS[soc.terminal_s0] ?= ""
#FVP_TERMINALS[soc.terminal_s1] ?= ""
#FVP_TERMINALS[board.terminal_0] ?= ""
#FVP_TERMINALS[board.terminal_1] ?= ""

#css.scp.pl011_uart_scp.out_file=rdn2/refinfra-1116064-uart-0-scp_2025-11-06_19.47.32
# css.scp.pl011_uart_scp.unbuffered_output=1
# css.scp.pl011_uart_scp.uart_enable=true
# css.mcp.pl011_uart_mcp.out_file=rdn2/refinfra-1116064-uart-0-mcp_2025-11-06_19.47.32
# css.mcp.pl011_uart_mcp.unbuffered_output=1
# css.pl011_ns_uart_ap.out_file=rdn2/refinfra-1116064-uart-0-nsec_2025-11-06_19.47.32
# css.pl011_ns_uart_ap.unbuffered_output=1
# css.pl011_ns_uart_ap.flow_ctrl_mask_en=1
# css.pl011_ns_uart_ap.enable_dc4=1
# css.pl011_s_uart_ap.out_file=rdn2/refinfra-1116064-uart-0-sec_2025-11-06_19.47.32
# css.pl011_s_uart_ap.unbuffered_output=1
# css.pl011_s_uart_ap.flow_ctrl_mask_en=1
# css.pl011_s_uart_ap.enable_dc4=0
# soc.pl011_uart0.flow_ctrl_mask_en=1
# soc.pl011_uart0.enable_dc4=0
```
