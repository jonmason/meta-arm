## meta-arm-bsp/conf/machine/fvp-common.inc
```bitbake
# FVP common parameters

#
# Capturing FVP common configurations (Armv8-A Base Platform FVP,
# Armv8-A Foundation Platform and Armv7-A Base Platform FVP).
#

MACHINE_FEATURES = "optee"

IMAGE_FSTYPES += "wic"
WKS_FILE ?= "fvp-base.wks"

SERIAL_CONSOLES = "115200;ttyAMA0"

PREFERRED_PROVIDER_virtual/kernel ?= "linux-yocto"

PREFERRED_VERSION_u-boot ?= "2021.10"

EXTRA_IMAGEDEPENDS += "trusted-firmware-a u-boot"

# As this is a virtual target that will not be used in the real world there is
# no need for real SSH keys.  Disable rng-tools (which takes too long to
# initialise) and install the pre-generated keys.
PACKAGECONFIG:remove:pn-openssh = "rng-tools"
MACHINE_EXTRA_RRECOMMENDS += "ssh-pregen-hostkeys"

TEST_TARGET = "OEFVPTarget"
```

## meta-arm-bsp/conf/machine/fvp-common/fvp.inc
```bitbake
# FVP common parameters

#
# Capturing FVP common configurations (Armv8-A Base Platform FVP and
# Armv8-A Foundation Platform).
#

TUNE_FEATURES = "aarch64"

require conf/machine/include/arm/arch-armv8a.inc

MACHINE_FEATURES = "optee"

KERNEL_IMAGETYPE = "Image"

IMAGE_CLASSES += "image_types_disk_img"
IMAGE_FSTYPES += "disk.img"

# Disk image configuration
# We don't use the first partition
DISK_IMG_PARTITION1_SIZE = "128"
DISK_IMG_PARTITION1_FSTYPE = ""
DISK_IMG_PARTITION1_CONTENT = ""

# Second partition is used for rootfs
DISK_IMG_PARTITION2_SIZE = "2048"
DISK_IMG_PARTITION2_FSTYPE = "ext4"
DISK_IMG_PARTITION2_CONTENT = "rootfs"

# Empty third partition (8G - 2048M - 128M)
DISK_IMG_PARTITION3_SIZE = "6016"
DISK_IMG_PARTITION3_FSTYPE = ""
DISK_IMG_PARTITION3_CONTENT = ""

SERIAL_CONSOLES = "115200;ttyAMA0"

PREFERRED_PROVIDER_virtual/kernel ?= "linux-yocto"
PREFERRED_VERSION_linux-yocto ?= "5.4%"

EXTRA_IMAGEDEPENDS += "virtual/trusted-firmware-a u-boot"

# FVP u-boot configuration
UBOOT_MACHINE = "vexpress_aemv8a_semi_defconfig"
```

## meta-arm-bsp/conf/machine/include/arm/arch-armv7m.inc
```bitbake
#
# Tune Settings for Cortex-M3
#
TUNEVALID[cortexm3] = "Enable Cortex-M3 specific processor optimizations"
TUNE_CCARGS .= "${@bb.utils.contains('TUNE_FEATURES', 'cortexm3', ' -mcpu=cortex-m3', '', d)}"


AVAILTUNES                            += "cortexm3"
ARMPKGARCH_tune-cortexm3               = "cortexm3"
TUNE_FEATURES_tune-cortexm3            = "${TUNE_FEATURES_tune-armv7m} cortexm3"
PACKAGE_EXTRA_ARCHS_tune-cortexm3      = "${PACKAGE_EXTRA_ARCHS_tune-armv7m} cortexm3"

#
# Defaults for ARMv7-m
#
DEFAULTTUNE ?= "armv7m"

TUNEVALID[armv7m] = "Enable instructions for ARMv7-m"
TUNE_CCARGS .= "${@bb.utils.contains('TUNE_FEATURES', 'armv7m', ' -march=armv7-m', '', d)}"
MACHINEOVERRIDES =. "${@bb.utils.contains('TUNE_FEATURES', 'armv7m', 'armv7m:', '', d)}"

TUNECONFLICTS[armv7m] = "armv4 armv5 armv6 armv7a"

require conf/machine/include/arm/arch-armv6m.inc


AVAILTUNES                            += "armv7m"
ARMPKGARCH_tune-armv7m                 = "armv7m"
TUNE_FEATURES_tune-armv7m              = "armv7m"
PACKAGE_EXTRA_ARCHS_tune-armv7m        = "armv7m"
```

## meta-arm-bsp/conf/machine/include/arm/arch-armv7r.inc
```bitbake
#
# Defaults for ARMv7-r
#
DEFAULTTUNE ?= "armv7r"

TUNEVALID[armv7r] = "Enable instructions for ARMv7-r"
TUNE_CCARGS_MARCH = "${@bb.utils.contains('TUNE_FEATURES', 'armv7r', ' -march=armv7-r', '', d)}"
MACHINEOVERRIDES =. "${@bb.utils.contains('TUNE_FEATURES', 'armv7r', 'armv7r:', '', d)}"

TUNECONFLICTS[armv7r] = "armv4 armv5 armv6 armv7a"

require conf/machine/include/arm/arch-armv6.inc
require conf/machine/include/arm/feature-arm-idiv.inc
require conf/machine/include/arm/feature-arm-neon.inc

AVAILTUNES                            += "armv7r armv7r-vfpv3d16"
ARMPKGARCH:tune-armv7r                 = "armv7r"
ARMPKGARCH:tune-armv7r-vfpv3d16        = "armv7r"
TUNE_FEATURES:tune-armv7r              = "armv7r"
TUNE_FEATURES:tune-armv7r-vfpv3d16     = "${TUNE_FEATURES:tune-armv7r} vfpv3d16"
PACKAGE_EXTRA_ARCHS:tune-armv7r        = "armv7r"
PACKAGE_EXTRA_ARCHS:tune-armv7r-vfpv3d16  = "${PACKAGE_EXTRA_ARCHS:tune-armv7r} tune-armv7r-fpv3d16"

# FIXME - This goes in arch-arm.inc when upstreamed
# Some -march settings need a +X option passed in.  Since we cannot guarantee that any specified TUNE_CCARGS option is set in any order, we must hard code the order here to allow for it.
TUNE_CCARGS_MARCH_OPTS ??= ""
TUNE_CCARGS .= "${TUNE_CCARGS_MARCH}${TUNE_CCARGS_MARCH_OPTS}"

# FIXME - Thise goes in feature-arm-neon.inc when upstreamed
TUNE_CCARGS_MARCH_OPTS .= "${@bb.utils.contains('TUNE_FEATURES', [ 'vfpv3d16', 'vfpv5spd16' ], '+fp', '', d)}"
```

## meta-arm-bsp/conf/machine/include/arm/arch-armv8m-main.inc
```bitbake
#
#
# Defaults for ARMv8-M.main
#
DEFAULTTUNE ?= "armv8m-main"

TUNEVALID[armv8m-main] = "Enable instructions for ARMv8-m.main"
TUNE_CCARGS .= "${@bb.utils.contains('TUNE_FEATURES', 'armv8m-main', ' -march=armv8-m.main', '', d)}"
MACHINEOVERRIDES =. "${@bb.utils.contains('TUNE_FEATURES', 'armv8m-main', 'armv8m-main:', '', d)}"

TUNECONFLICTS[armv8m-main] = "armv4 armv5 armv6 armv7a"

require conf/machine/include/arm/arch-armv8m-base.inc


AVAILTUNES                          += "armv8m-main"
ARMPKGARCH_tune-armv8m-main          = "armv8m-main"
TUNE_FEATURES_tune-armv8m-main       = "armv8m-main"
PACKAGE_EXTRA_ARCHS_tune-armv8m-main = "armv8m-main"
```

## meta-arm-bsp/conf/machine/include/arm/armv8r/arch-armv8r64.inc
```bitbake
DEFAULTTUNE ?= "armv8r"

TUNEVALID[armv8r] = "Enable instructions for ARMv8-r"
TUNE_CCARGS .= "${@bb.utils.contains('TUNE_FEATURES', 'armv8r', ' -march=armv8-r', '', d)}"
TUNEVALID[crc] = "Enable instructions for ARMv8-r Cyclic Redundancy Check (CRC)"
TUNE_CCARGS .= "${@bb.utils.contains('TUNE_FEATURES', 'crc', '+crc', '', d)}"
TUNEVALID[crypto] = "Enable instructions for ARMv8-r cryptographic"
TUNE_CCARGS .= "${@bb.utils.contains('TUNE_FEATURES', 'crypto', '+crypto', '', d)}"
MACHINEOVERRIDES =. "${@bb.utils.contains('TUNE_FEATURES', 'armv8r', 'armv8-r:', '', d)}"

require conf/machine/include/arm/arch-arm64.inc

# Little Endian base configs
AVAILTUNES += "armv8r armv8r-crc armv8r-crypto"
ARMPKGARCH:tune-armv8r                    ?= "armv8r"
ARMPKGARCH:tune-armv8r-crc                ?= "armv8r"
ARMPKGARCH:tune-armv8r-crypto             ?= "armv8r"
TUNE_FEATURES:tune-armv8r                  = "aarch64 armv8r"
TUNE_FEATURES:tune-armv8r-crc              = "${TUNE_FEATURES:tune-armv8r} crc"
TUNE_FEATURES:tune-armv8r-crypto           = "${TUNE_FEATURES:tune-armv8r} crypto"
PACKAGE_EXTRA_ARCHS:tune-armv8r            = "aarch64 armv8r"
PACKAGE_EXTRA_ARCHS:tune-armv8r-crc        = "${PACKAGE_EXTRA_ARCHS:tune-armv8r} armv8r-crc"
PACKAGE_EXTRA_ARCHS:tune-armv8r-crypto     = "${PACKAGE_EXTRA_ARCHS:tune-armv8r} armv8r-crypto"
BASE_LIB:tune-armv8r                       = "lib64"
BASE_LIB:tune-armv8r-crc                   = "lib64"
BASE_LIB:tune-armv8r-crypto                = "lib64"
```

## meta-arm-bsp/conf/machine/include/corstone1000.inc
```bitbake
require conf/machine/include/arm/armv8a/tune-cortexa35.inc

MACHINEOVERRIDES =. "corstone1000:"

# TF-M
PREFERRED_VERSION_trusted-firmware-m ?= "1.8.%"

# TF-A
TFA_PLATFORM = "corstone1000"
PREFERRED_VERSION_trusted-firmware-a ?= "2.9.%"
PREFERRED_VERSION_tf-a-tests ?= "2.8.%"

TFA_BL2_BINARY = "bl2-corstone1000.bin"
TFA_FIP_BINARY = "fip-corstone1000.bin"

# optee
PREFERRED_VERSION_optee-os ?= "4.1.%"

# Trusted Services
TS_PLATFORM = "arm/corstone1000"
TS_SP_SE_PROXY_CONFIG = "corstone1000"
# Include smm-gateway and se-proxy SPs into optee-os binary
MACHINE_FEATURES += "ts-smm-gateway ts-se-proxy"

# u-boot
PREFERRED_VERSION_u-boot ?= "2023.07%"
MACHINE_FEATURES += "efi"
EFI_PROVIDER ?= "grub-efi"

# Grub
LINUX_KERNEL_ARGS ?= "earlycon=pl011,0x1a510000 console=ttyAMA0,115200"
GRUB_LINUX_APPEND ?= "${LINUX_KERNEL_ARGS}"
IMAGE_CMD:wic[vardeps] += "GRUB_LINUX_APPEND"

# Linux kernel
PREFERRED_PROVIDER_virtual/kernel:forcevariable = "linux-yocto"
PREFERRED_VERSION_linux-yocto = "6.6.%"
KERNEL_IMAGETYPE = "Image.gz"
# add FF-A support in the kernel
MACHINE_FEATURES += "arm-ffa"
# enable this feature for kernel debugging
# MACHINE_FEATURES += "corstone1000_kernel_debug"
# Telling the build system which image is responsible of the generation of the initramfs rootfs
INITRAMFS_IMAGE_BUNDLE = "1"
INITRAMFS_IMAGE ?= "corstone1000-initramfs-image"
IMAGE_NAME_SUFFIX = ""

# login terminal serial port settings
SERIAL_CONSOLES ?= "115200;ttyAMA0"

WKS_FILE ?= "corstone1000-image.corstone1000.wks"

# making sure EXTRA_IMAGEDEPENDS will be used while creating the image
WKS_FILE_DEPENDS:append = " ${EXTRA_IMAGEDEPENDS}"

# prevent the kernel image from being included in the intramfs rootfs
PACKAGE_EXCLUDE += "kernel-image-*"
# Don't include kernel binary in rootfs /boot path
RRECOMMENDS:${KERNEL_PACKAGE_NAME}-base = ""

# Disable python usage in opkg-utils since it won't build with tiny config
PACKAGECONFIG:remove:pn-opkg-utils = "python"
# Disable openssl in kmod to shink the initramfs size
PACKAGECONFIG:remove:pn-kmod = "openssl"
```

## meta-arm-bsp/conf/machine/include/corstone700.inc
```bitbake
# Common configuration for all Corstone700 machines

require conf/machine/include/arm/armv8a/tune-cortexa32.inc

MACHINEOVERRIDES =. "corstone700:"

TFA_PLATFORM = "corstone700"

SERIAL_CONSOLES ?= "115200;ttyAMA0"

PREFERRED_PROVIDER_virtual/kernel = "linux-yocto"
PREFERRED_VERSION_linux-yocto ?= "5.6%"

PREFERRED_VERSION_trusted-firmware-a ?= "2.5%"

PREFERRED_VERSION_gcc-arm-none-eabi-native ?= "9-2020-q2-update"

PREFERRED_PROVIDER_virtual/control-processor-firmware ?= "boot-firmware"

EXTRA_IMAGEDEPENDS += " \
                      virtual/trusted-firmware-a          \
                      external-system                     \
                      u-boot                              \
                      virtual/control-processor-firmware  \
                      "

WKS_FILE_DEPENDS:append = " ${EXTRA_IMAGEDEPENDS}"

WKS_FILE ?= "arm-reference-image.corstone700.wks"

VIRTUAL-RUNTIME_dev_manager = "busybox-mdev"

UBOOT_MACHINE ?= "corstone700_defconfig"
PREFERRED_VERSION_u-boot ?= "2020.04"
```

## meta-arm-bsp/conf/machine/include/tune-cortexa73-cortexa35.inc
```bitbake
DEFAULTTUNE ?= "cortexa73-cortexa35"

TUNEVALID[cortexa73-cortexa35] = "Enable big.LITTLE Cortex-A73.Cortex-A35 specific processor optimizations"
TUNECONFLICTS[aarch64] = "armv4 armv5 armv6 armv7 armv7a"
MACHINEOVERRIDES =. "${@bb.utils.contains("TUNE_FEATURES", "cortexa73-cortexa35", "cortexa73-cortexa35:", "" ,d)}"
TUNE_CCARGS .= "${@bb.utils.contains("TUNE_FEATURES", "cortexa73-cortexa35", " -mcpu=cortex-a73.cortex-a35", "", d)}"

require conf/machine/include/arm/arch-armv8a.inc

# cortexa73.cortexa35 implies crc support
AVAILTUNES += "cortexa73-cortexa35 cortexa73-cortexa35-crypto"
ARMPKGARCH_tune-cortexa73-cortexa35                  = "cortexa73-cortexa35"
ARMPKGARCH_tune-cortexa73-cortexa35-crypto           = "cortexa73-cortexa35-crypto"
TUNE_FEATURES_tune-cortexa73-cortexa35               = "aarch64 crc cortexa73-cortexa35"
TUNE_FEATURES_tune-cortexa73-cortexa35-crypto        = "aarch64 crc crypto cortexa73-cortexa35"
PACKAGE_EXTRA_ARCHS_tune-cortexa73-cortexa35         = "${PACKAGE_EXTRA_ARCHS_tune-armv8a-crc}        cortexa73-cortexa35"
PACKAGE_EXTRA_ARCHS_tune-cortexa73-cortexa35-crypto  = "${PACKAGE_EXTRA_ARCHS_tune-armv8a-crc-crypto} cortexa73-cortexa35 cortexa73-cortexa35-crypto"
BASE_LIB_tune-cortexa73-cortexa35                    = "lib64"
BASE_LIB_tune-cortexa73-cortexa35-crypto             = "lib64"
```

## meta-arm-bsp/conf/machine/include/tune-cortexa75-cortexa55.inc
```bitbake
DEFAULTTUNE ?= "cortexa75-cortexa55"

TUNEVALID[cortexa75-cortexa55] = "Enable big.LITTLE Cortex-A75.Cortex-A55 specific processor optimizations"
TUNECONFLICTS[aarch64] = "armv4 armv5 armv6 armv7 armv7a"
MACHINEOVERRIDES =. "${@bb.utils.contains("TUNE_FEATURES", "cortexa75-cortexa55", "cortexa75-cortexa55:", "" ,d)}"
TUNE_CCARGS .= "${@bb.utils.contains("TUNE_FEATURES", "cortexa75-cortexa55", " -mcpu=cortex-a75.cortex-a55", "", d)}"

require conf/machine/include/arm/arch-armv8-2a.inc

# cortexa75.cortexa55 implies crc support
AVAILTUNES += "cortexa75-cortexa55 cortexa75-cortexa55-crypto"
ARMPKGARCH_tune-cortexa75-cortexa55                  = "cortexa75-cortexa55"
ARMPKGARCH_tune-cortexa75-cortexa55-crypto           = "cortexa75-cortexa55-crypto"
TUNE_FEATURES_tune-cortexa75-cortexa55               = "aarch64 crc cortexa75-cortexa55"
TUNE_FEATURES_tune-cortexa75-cortexa55-crypto        = "aarch64 crc crypto cortexa75-cortexa55"
PACKAGE_EXTRA_ARCHS_tune-cortexa75-cortexa55         = "${PACKAGE_EXTRA_ARCHS_tune-armv8a-crc}        cortexa75-cortexa55"
PACKAGE_EXTRA_ARCHS_tune-cortexa75-cortexa55-crypto  = "${PACKAGE_EXTRA_ARCHS_tune-armv8a-crc-crypto} cortexa75-cortexa55 cortexa75-cortexa55-crypto"
BASE_LIB_tune-cortexa75-cortexa55                    = "lib64"
BASE_LIB_tune-cortexa75-cortexa55-crypto             = "lib64"
```

## meta-arm-bsp/conf/machine/include/tune-cortexa75.inc
```bitbake
DEFAULTTUNE ?= "cortexa75"

TUNEVALID[cortexa75] = "Enable Cortex-A75 specific processor optimizations"
TUNE_CCARGS .= "${@bb.utils.contains('TUNE_FEATURES', 'cortexa75', ' -mcpu=cortex-a75', '', d)}"

require conf/machine/include/arm/arch-armv8-2a.inc

# Little Endian base configs
AVAILTUNES += "cortexa75"
ARMPKGARCH_tune-cortexa75             = "cortexa75"
TUNE_FEATURES_tune-cortexa75          = "aarch64 cortexa75 crc crypto"
PACKAGE_EXTRA_ARCHS_tune-cortexa75    = "${PACKAGE_EXTRA_ARCHS_tune-armv8a-crc-crypto} cortexa75"
BASE_LIB_tune-cortexa75               = "lib64"
```

## meta-arm-bsp/conf/machine/include/tune-cortexa76-cortexa55.inc
```bitbake
DEFAULTTUNE ?= "cortexa76-cortexa55"

TUNEVALID[cortexa76-cortexa55] = "Enable big.LITTLE Cortex-A76.Cortex-A55 specific processor optimizations"
TUNECONFLICTS[aarch64] = "armv4 armv5 armv6 armv7 armv7a"
MACHINEOVERRIDES =. "${@bb.utils.contains("TUNE_FEATURES", "cortexa76-cortexa55", "cortexa76-cortexa55:", "" ,d)}"
TUNE_CCARGS .= "${@bb.utils.contains("TUNE_FEATURES", "cortexa76-cortexa55", " -mcpu=cortex-a76.cortex-a55", "", d)}"

require conf/machine/include/arm/arch-armv8-2a.inc

# cortexa76.cortexa55 implies crc support
AVAILTUNES += "cortexa76-cortexa55 cortexa76-cortexa55-crypto"
ARMPKGARCH_tune-cortexa76-cortexa55                  = "cortexa76-cortexa55"
ARMPKGARCH_tune-cortexa76-cortexa55-crypto           = "cortexa76-cortexa55-crypto"
TUNE_FEATURES_tune-cortexa76-cortexa55               = "aarch64 crc cortexa76-cortexa55"
TUNE_FEATURES_tune-cortexa76-cortexa55-crypto        = "aarch64 crc crypto cortexa76-cortexa55"
PACKAGE_EXTRA_ARCHS_tune-cortexa76-cortexa55         = "${PACKAGE_EXTRA_ARCHS_tune-armv8a-crc}        cortexa76-cortexa55"
PACKAGE_EXTRA_ARCHS_tune-cortexa76-cortexa55-crypto  = "${PACKAGE_EXTRA_ARCHS_tune-armv8a-crc-crypto} cortexa76-cortexa55 cortexa76-cortexa55-crypto"
BASE_LIB_tune-cortexa76-cortexa55                    = "lib64"
BASE_LIB_tune-cortexa76-cortexa55-crypto             = "lib64"
```

## meta-arm-bsp/conf/machine/include/tune-cortexm0.inc
```bitbake
#
# Tune Settings for Cortex-M0
#
DEFAULTTUNE ?= "cortexm0"

TUNEVALID[cortexm0] = "Enable Cortex-M0 specific processor optimizations"
TUNE_CCARGS .= "${@bb.utils.contains('TUNE_FEATURES', 'cortexm0', ' -mcpu=cortex-m0', '', d)}"

require conf/machine/include/arm/arch-armv6m.inc

AVAILTUNES                            += "cortexm0"
ARMPKGARCH:tune-cortexm0               = "cortexm0"
TUNE_FEATURES:tune-cortexm0            = "${TUNE_FEATURES:tune-armv6m} cortexm0"
PACKAGE_EXTRA_ARCHS:tune-cortexm0      = "${PACKAGE_EXTRA_ARCHS:tune-armv6m} cortexm0"
```
