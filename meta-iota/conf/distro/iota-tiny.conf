## meta-iota/conf/distro/iota-tiny.conf
```bitbake
# SPDX-License-Identifier: MIT
#
# Copyright (c) 2019 Arm Limited
#

require conf/distro/poky-tiny.conf

DISTRO_NAME = "Iota - Tiny Linux Distribution"
DISTRO = "iota-tiny"
DISTRO_VERSION = "0.1"

PREFERRED_PROVIDER_virtual/kernel = "linux-arm"

INHERIT += "image-buildinfo"

TCLIBC = "musl"
```

## meta-iota/conf/layer.conf
```bitbake
# SPDX-License-Identifier: MIT
#
# Copyright (c) 2019 Arm Limited
#

# iota has a conf and classes directory, add to BBPATH
BBPATH .= ":${LAYERDIR}"

# iota has a packages directory, add to BBFILES
BBFILES += " \
		${LAYERDIR}/recipes-*/*/*.bb \
		${LAYERDIR}/recipes-*/*/*.bbappend"

BBFILE_COLLECTIONS += "iota"
BBFILE_PATTERN_iota := "^${LAYERDIR}/"
BBFILE_PRIORITY_iota = "14"
LAYERSERIES_COMPAT_iota = "warrior"
```

## meta-iota/wic/iota-vexpress-a5.wks
```
# Partition for vexpress-a5


# Rawcopy of the FIP binary
part --source rawcopy --sourceparams="file=fvp_ve.fip" --no-table --align 1 --fixed-size 1

# Rawcopy of the kernel binary
part --source rawcopy --sourceparams="file=zImage" --no-table --fixed-size 12

# Rawcopy of the rootfs
part --source rawcopy --sourceparams="file=iota-tiny-image-vexpress-a5.cpio.gz" --no-table
```
